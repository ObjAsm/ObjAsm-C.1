; ==================================================================================================
; Title:      PlotUEFI_Shared.inc
; Author:     HИctor S. Enrique
; Version:    C.1.0
; Purpose:    ObjAsm NUI Template.
; Notes:      Version C.1.0, June 2022
;               - First release.
; ==================================================================================================


;General information
APP_TITLE                     textequ   <PlotUEFI>
ABOUT_TEXT                    textequ   <PlotUEFI>
COPYRIGHT                     textequ   <HИctor S. Enrique  June 2022> 
VER_FILEVERSION               equ       1,0,0,0
VER_FILEVERSION_STR           textequ   <1.0>
VER_PRODUCTVERSION            equ       1,0,0,0
VER_PRODUCTVERSION_STR        equ       <1.0>

;Build information - updated automatically -
BUILD_NUMBER                  equ       28
BUILD_DATE_STR                textequ   <2022-12-05>
BUILD_BITNESS                 equ       64
BUILD_MODE                    equ       RLS

