.data
EFI_SIMPLE_POINTER_PROTOCOL_GUID       EFI_GUID <0x31878c87, 0xb75,  0x11d5, {0x9a, 0x4f, 0x00, 0x90, 0x27, 0x3f, 0xc1, 0x4d}>
EFI_SIMPLE_TEXT_OUTPUT_PROTOCOL_GUID   EFI_GUID <0x387477c2, 0x69c7, 0x11d2, {0x8e, 0x39, 0x00, 0xa0, 0xc9, 0x69, 0x72, 0x3b}>
EFI_SIMPLE_TEXT_INPUT_PROTOCOL_GUID    EFI_GUID <0x387477c1, 0x69c7, 0x11d2, {0x8e, 0x39, 0x00, 0xa0, 0xc9, 0x69, 0x72, 0x3b}>
EFI_SIMPLE_TEXT_INPUT_EX_PROTOCOL_GUID EFI_GUID <0xDD9E7534, 0x7762, 0x4698, {0x8C, 0x14, 0xF5, 0x85, 0x17, 0xA6, 0x25, 0xAA}>
EFI_GRAPHICS_OUTPUT_PROTOCOL_GUID      EFI_GUID <0x9042a9de, 0x23dc, 0x4a38, {0x96, 0xfb, 0x7a, 0xde, 0xd0, 0x80, 0x51, 0x6a}>
EFI_EDID_DISCOVERED_PROTOCOL_GUID      EFI_GUID <0x1c0c34f6, 0xd380, 0x41fa, {0xa0, 0x49, 0x8a, 0xd0, 0x6c, 0x1a, 0x66, 0xaa}>
EFI_EDID_ACTIVE_PROTOCOL_GUID          EFI_GUID <0xbd8c1056, 0x9f36, 0x44ec, {0x92, 0xa8, 0xa6, 0x33, 0x7f, 0x81, 0x79, 0x86}>
EFI_EDID_OVERRIDE_PROTOCOL_GUID        EFI_GUID <0x48ecb431, 0xfb72, 0x45c0, {0xa9, 0x22, 0xf4, 0x58, 0xfe, 0x04, 0x0b, 0xd5}>
EFI_LOAD_FILE_PROTOCOL_GUID            EFI_GUID <0x56EC3091, 0x954C, 0x11d2, {0x8e, 0x3f, 0x00, 0xa0, 0xc9, 0x69, 0x72, 0x3b}>
EFI_SIMPLE_FILE_SYSTEM_PROTOCOL_GUID   EFI_GUID <0x0964e5b22,0x6459, 0x11d2, {0x8e, 0x39, 0x00, 0xa0, 0xc9, 0x69, 0x72, 0x3b}>
EFI_FILE_INFO_ID                       EFI_GUID <0x09576e92, 0x6d3f, 0x11d2, {0x8e, 0x39, 0x00, 0xa0, 0xc9, 0x69, 0x72, 0x3b}>
EFI_FILE_SYSTEM_INFO_ID                EFI_GUID <0x09576e93, 0x6d3f, 0x11d2, {0x8e, 0x39, 0x00, 0xa0, 0xc9, 0x69, 0x72, 0x3b}>
EFI_FILE_SYSTEM_VOLUME_LABEL_ID        EFI_GUID <0xdb47d7d3, 0xfe81, 0x11d3, {0x9a, 0x35, 0x00, 0x90, 0x27, 0x3f, 0xC1, 0x4d}>
EFI_MP_SERVICES_PROTOCOL_GUID          EFI_GUID <0x3fdda605, 0xa76e, 0x4f46, {0xad, 0x29, 0x12, 0xf4, 0x53, 0x1b, 0x3d, 0x08}>

;---------------------------------------------------------------------------
; EFI Event GUIDS
;---------------------------------------------------------------------------
EFI_EVENT_GROUP_EXIT_BOOT_SERVICES     EFI_GUID <0x27abf055, 0xb1b8, 0x4c26, {0x80, 0x48, 0x74, 0x8f, 0x37, 0xba, 0xa2, 0xdf}>
EFI_EVENT_GROUP_VIRTUAL_ADDRESS_CHANGE EFI_GUID <0x13fa7698, 0xc831, 0x49c7, {0x87, 0xea, 0x8f, 0x43, 0xfc, 0xc2, 0x51, 0x96}>
EFI_EVENT_GROUP_MEMORY_MAP_CHANGE      EFI_GUID <0x78bee926, 0x692f, 0x48fd, {0x9e, 0xdb, 0x1,  0x42, 0x2e, 0xf0, 0xd7, 0xab}>
EFI_EVENT_GROUP_READY_TO_BOOT          EFI_GUID <0x7ce88fb3, 0x4bd7, 0x4679, {0x87, 0xa8, 0xa8, 0xd8, 0xde, 0xe5, 0xd,  0x2b}>

;---------------------------------------------------------------------------
; EFI Configuration Table and GUID definitions
;---------------------------------------------------------------------------
MPS_TABLE_GUID        EFI_GUID <0xeb9d2d2f, 0x2d88, 0x11d3, {0x9a, 0x16, 0x0, 0x90, 0x27, 0x3f, 0xc1, 0x4d}>
ACPI_TABLE_GUID       EFI_GUID <0xeb9d2d30, 0x2d88, 0x11d3, {0x9a, 0x16, 0x0, 0x90, 0x27, 0x3f, 0xc1, 0x4d}>
ACPI_20_TABLE_GUID    EFI_GUID <0x8868e871, 0xe4f1, 0x11d3, {0xbc, 0x22, 0x0, 0x80, 0xc7, 0x3c, 0x88, 0x81}>
SMBIOS_TABLE_GUID     EFI_GUID <0xeb9d2d31, 0x2d88, 0x11d3, {0x9a, 0x16, 0x0, 0x90, 0x27, 0x3f, 0xc1, 0x4d}>
SAL_SYSTEM_TABLE_GUID EFI_GUID <0xeb9d2d32, 0x2d88, 0x11d3, {0x9a, 0x16, 0x0, 0x90, 0x27, 0x3f, 0xc1, 0x4d}>
SMBIOS3_TABLE_GUID    EFI_GUID <0xf2fd1544, 0x9794, 0x4a2c, {0x99,0x2e,0xe5,0xbb,0xcf,0x20,0xe3,0x94}>

;
; ACPI 2.0 or newer tables should use EFI_ACPI_TABLE_GUID
;
EFI_ACPI_TABLE_GUID       EFI_GUID <0x8868e871, 0xe4f1, 0x11d3, {0xbc,0x22,0x00,0x80,0xc7,0x3c,0x88,0x81}>
ACPI_10_TABLE_GUID        EFI_GUID <0xeb9d2d30, 0x2d88, 0x11d3, {0x9a,0x16,0x00,0x90,0x27,0x3f,0xc1,0x4d}>
EFI_PROPERTIES_TABLE_GUID EFI_GUID <0x880aaca3, 0x4adc, 0x4a04, {0x90,0x79,0xb7,0x47,0x34,0x8,0x25,0xe5}>

