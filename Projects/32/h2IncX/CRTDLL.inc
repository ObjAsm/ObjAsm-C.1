; include file generated by lib2inc V1.2

_CIacos PROTO C :VARARG
_CIasin PROTO C :VARARG
_CIatan PROTO C :VARARG
_CIatan2 PROTO C :VARARG
_CIcos PROTO C :VARARG
_CIcosh PROTO C :VARARG
_CIexp PROTO C :VARARG
_CIfmod PROTO C :VARARG
_CIlog PROTO C :VARARG
_CIlog10 PROTO C :VARARG
_CIpow PROTO C :VARARG
_CIsin PROTO C :VARARG
_CIsinh PROTO C :VARARG
_CIsqrt PROTO C :VARARG
_CItan PROTO C :VARARG
_CItanh PROTO C :VARARG
_HUGE_dll PROTO C :VARARG
_XcptFilter PROTO C :VARARG
__GetMainArgs PROTO C :VARARG
__argc_dll PROTO C :VARARG
__argv_dll PROTO C :VARARG
__dllonexit PROTO C :VARARG
;__doserrno PROTO C :VARARG
__fpecode PROTO C :VARARG
;__isascii PROTO C :VARARG
;__iscsym PROTO C :VARARG
;__iscsymf PROTO C :VARARG
__mb_cur_max_dll PROTO C :VARARG
__pxcptinfoptrs PROTO C :VARARG
__threadhandle PROTO C :VARARG
__threadid PROTO C :VARARG
;__toascii PROTO C :VARARG
;_abnormal_termination PROTO C :VARARG
_access PROTO C :VARARG
_acmdln_dll PROTO C :VARARG
_aexit_rtn_dll PROTO C :VARARG
_amsg_exit PROTO C :VARARG
_assert PROTO C :VARARG
_basemajor_dll PROTO C :VARARG
_baseminor_dll PROTO C :VARARG
_baseversion_dll PROTO C :VARARG
;_beep PROTO C :VARARG
_beginthread PROTO C :VARARG
_c_exit PROTO C :VARARG
_cabs PROTO C :VARARG
_cexit PROTO C :VARARG
_cgets PROTO C :VARARG
_chdir PROTO C :VARARG
_chdrive PROTO C :VARARG
_chgsign PROTO C :VARARG
_chmod PROTO C :VARARG
_chsize PROTO C :VARARG
_clearfp PROTO C :VARARG
_close PROTO C :VARARG
_commit PROTO C :VARARG
_commode_dll PROTO C :VARARG
_control87 PROTO C :VARARG
_controlfp PROTO C :VARARG
_copysign PROTO C :VARARG
_cprintf PROTO C :VARARG
_cpumode_dll PROTO C :VARARG
_cputs PROTO C :VARARG
_creat PROTO C :VARARG
_cscanf PROTO C :VARARG
_ctype PROTO C :VARARG
_cwait PROTO C :VARARG
_daylight_dll PROTO C :VARARG
_dup PROTO C :VARARG
_dup2 PROTO C :VARARG
;_ecvt PROTO C :VARARG
_endthread PROTO C :VARARG
_environ_dll PROTO C :VARARG
_eof PROTO C :VARARG
;_errno PROTO C :VARARG
_except_handler2 PROTO C :VARARG
_execl PROTO C :VARARG
_execle PROTO C :VARARG
_execlp PROTO C :VARARG
_execlpe PROTO C :VARARG
_execv PROTO C :VARARG
_execve PROTO C :VARARG
_execvp PROTO C :VARARG
_execvpe PROTO C :VARARG
;_exit PROTO C :VARARG
_expand PROTO C :VARARG
_fcloseall PROTO C :VARARG
;_fcvt PROTO C :VARARG
_fdopen PROTO C :VARARG
_fgetchar PROTO C :VARARG
_fgetwchar PROTO C :VARARG
_filbuf PROTO C :VARARG
_fileinfo_dll PROTO C :VARARG
_filelength PROTO C :VARARG
_fileno PROTO C :VARARG
_findclose PROTO C :VARARG
_findfirst PROTO C :VARARG
_findnext PROTO C :VARARG
_finite PROTO C :VARARG
_flsbuf PROTO C :VARARG
_flushall PROTO C :VARARG
_fmode_dll PROTO C :VARARG
_fpclass PROTO C :VARARG
_fpieee_flt PROTO C :VARARG
_fpreset PROTO C :VARARG
_fputchar PROTO C :VARARG
_fputwchar PROTO C :VARARG
_fsopen PROTO C :VARARG
_fstat PROTO C :VARARG
_ftime PROTO C :VARARG
_ftol PROTO C :VARARG
;_fullpath PROTO C :VARARG
_futime PROTO C :VARARG
;_gcvt PROTO C :VARARG
_get_osfhandle PROTO C :VARARG
_getch PROTO C :VARARG
_getche PROTO C :VARARG
_getcwd PROTO C :VARARG
_getdcwd PROTO C :VARARG
_getdiskfree PROTO C :VARARG
_getdllprocaddr PROTO C :VARARG
_getdrive PROTO C :VARARG
_getdrives PROTO C :VARARG
_getpid PROTO C :VARARG
_getsystime PROTO C :VARARG
_getw PROTO C :VARARG
_global_unwind2 PROTO C :VARARG
_heapchk PROTO C :VARARG
_heapmin PROTO C :VARARG
_heapset PROTO C :VARARG
_heapwalk PROTO C :VARARG
_hypot PROTO C :VARARG
_initterm PROTO C :VARARG
_iob PROTO C :VARARG
_isatty PROTO C :VARARG
;_isctype PROTO C :VARARG
_ismbbalnum PROTO C :VARARG
_ismbbalpha PROTO C :VARARG
_ismbbgraph PROTO C :VARARG
_ismbbkalnum PROTO C :VARARG
_ismbbkana PROTO C :VARARG
_ismbbkpunct PROTO C :VARARG
_ismbblead PROTO C :VARARG
_ismbbprint PROTO C :VARARG
_ismbbpunct PROTO C :VARARG
_ismbbtrail PROTO C :VARARG
_ismbcalpha PROTO C :VARARG
_ismbcdigit PROTO C :VARARG
_ismbchira PROTO C :VARARG
_ismbckata PROTO C :VARARG
_ismbcl0 PROTO C :VARARG
_ismbcl1 PROTO C :VARARG
_ismbcl2 PROTO C :VARARG
_ismbclegal PROTO C :VARARG
_ismbclower PROTO C :VARARG
_ismbcprint PROTO C :VARARG
_ismbcspace PROTO C :VARARG
_ismbcsymbol PROTO C :VARARG
_ismbcupper PROTO C :VARARG
_ismbslead PROTO C :VARARG
_ismbstrail PROTO C :VARARG
_isnan PROTO C :VARARG
_itoa PROTO C :VARARG
_itow PROTO C :VARARG
_j0 PROTO C :VARARG
_j1 PROTO C :VARARG
_jn PROTO C :VARARG
_kbhit PROTO C :VARARG
_lfind PROTO C :VARARG
_loaddll PROTO C :VARARG
_local_unwind2 PROTO C :VARARG
_locking PROTO C :VARARG
_logb PROTO C :VARARG
;_lrotl PROTO C :VARARG
;_lrotr PROTO C :VARARG
_lsearch PROTO C :VARARG
_lseek PROTO C :VARARG
_ltoa PROTO C :VARARG
_ltow PROTO C :VARARG
_makepath PROTO C :VARARG
_matherr PROTO C :VARARG
_mbbtombc PROTO C :VARARG
_mbbtype PROTO C :VARARG
_mbccpy PROTO C :VARARG
_mbcjistojms PROTO C :VARARG
_mbcjmstojis PROTO C :VARARG
_mbclen PROTO C :VARARG
_mbctohira PROTO C :VARARG
_mbctokata PROTO C :VARARG
_mbctolower PROTO C :VARARG
_mbctombb PROTO C :VARARG
_mbctoupper PROTO C :VARARG
_mbctype PROTO C :VARARG
_mbsbtype PROTO C :VARARG
_mbscat PROTO C :VARARG
_mbschr PROTO C :VARARG
_mbscmp PROTO C :VARARG
_mbscpy PROTO C :VARARG
_mbscspn PROTO C :VARARG
_mbsdec PROTO C :VARARG
_mbsdup PROTO C :VARARG
_mbsicmp PROTO C :VARARG
_mbsinc PROTO C :VARARG
_mbslen PROTO C :VARARG
_mbslwr PROTO C :VARARG
_mbsnbcat PROTO C :VARARG
_mbsnbcmp PROTO C :VARARG
_mbsnbcnt PROTO C :VARARG
_mbsnbcpy PROTO C :VARARG
_mbsnbicmp PROTO C :VARARG
_mbsnbset PROTO C :VARARG
_mbsncat PROTO C :VARARG
_mbsnccnt PROTO C :VARARG
_mbsncmp PROTO C :VARARG
_mbsncpy PROTO C :VARARG
_mbsnextc PROTO C :VARARG
_mbsnicmp PROTO C :VARARG
_mbsninc PROTO C :VARARG
_mbsnset PROTO C :VARARG
_mbspbrk PROTO C :VARARG
_mbsrchr PROTO C :VARARG
_mbsrev PROTO C :VARARG
_mbsset PROTO C :VARARG
_mbsspn PROTO C :VARARG
_mbsspnp PROTO C :VARARG
_mbsstr PROTO C :VARARG
_mbstok PROTO C :VARARG
;_mbstrlen PROTO C :VARARG
_mbsupr PROTO C :VARARG
;_memccpy PROTO C :VARARG
;_memicmp PROTO C :VARARG
_mkdir PROTO C :VARARG
_mktemp PROTO C :VARARG
_msize PROTO C :VARARG
_nextafter PROTO C :VARARG
;_onexit PROTO C :VARARG
_open PROTO C :VARARG
_open_osfhandle PROTO C :VARARG
_osmajor_dll PROTO C :VARARG
_osminor_dll PROTO C :VARARG
_osmode_dll PROTO C :VARARG
_osver_dll PROTO C :VARARG
_osversion_dll PROTO C :VARARG
_pclose PROTO C :VARARG
_pctype_dll PROTO C :VARARG
_pgmptr_dll PROTO C :VARARG
_pipe PROTO C :VARARG
_popen PROTO C :VARARG
_purecall PROTO C :VARARG
_putch PROTO C :VARARG
;_putenv PROTO C :VARARG
_putw PROTO C :VARARG
_pwctype_dll PROTO C :VARARG
_read PROTO C :VARARG
_rmdir PROTO C :VARARG
_rmtmp PROTO C :VARARG
;_rotl PROTO C :VARARG
;_rotr PROTO C :VARARG
_scalb PROTO C :VARARG
_searchenv PROTO C :VARARG
;_seterrormode PROTO C :VARARG
_setjmp PROTO C :VARARG
_setmode PROTO C :VARARG
_setsystime PROTO C :VARARG
;_sleep PROTO C :VARARG
_snprintf PROTO C :VARARG
_snwprintf PROTO C :VARARG
_sopen PROTO C :VARARG
_spawnl PROTO C :VARARG
_spawnle PROTO C :VARARG
_spawnlp PROTO C :VARARG
_spawnlpe PROTO C :VARARG
_spawnv PROTO C :VARARG
_spawnve PROTO C :VARARG
_spawnvp PROTO C :VARARG
_spawnvpe PROTO C :VARARG
;_splitpath PROTO C :VARARG
_stat PROTO C :VARARG
_statusfp PROTO C :VARARG
;_strcmpi PROTO C :VARARG
_strdate PROTO C :VARARG
_strdec PROTO C :VARARG
;_strdup PROTO C :VARARG
;_strerror PROTO C :VARARG
;_stricmp PROTO C :VARARG
;_stricoll PROTO C :VARARG
_strinc PROTO C :VARARG
_strlwr PROTO C :VARARG
_strncnt PROTO C :VARARG
_strnextc PROTO C :VARARG
;_strnicmp PROTO C :VARARG
_strninc PROTO C :VARARG
_strnset PROTO C :VARARG
;_strrev PROTO C :VARARG
_strset PROTO C :VARARG
_strspnp PROTO C :VARARG
_strtime PROTO C :VARARG
_strupr PROTO C :VARARG
;_swab PROTO C :VARARG
;_sys_errlist PROTO C :VARARG
_sys_nerr_dll PROTO C :VARARG
_tell PROTO C :VARARG
_tempnam PROTO C :VARARG
_timezone_dll PROTO C :VARARG
;_tolower PROTO C :VARARG
;_toupper PROTO C :VARARG
_tzname PROTO C :VARARG
_tzset PROTO C :VARARG
_ultoa PROTO C :VARARG
_ultow PROTO C :VARARG
_umask PROTO C :VARARG
_ungetch PROTO C :VARARG
_unlink PROTO C :VARARG
_unloaddll PROTO C :VARARG
_utime PROTO C :VARARG
_vsnprintf PROTO C :VARARG
_vsnwprintf PROTO C :VARARG
;_wcsdup PROTO C :VARARG
;_wcsicmp PROTO C :VARARG
;_wcsicoll PROTO C :VARARG
_wcslwr PROTO C :VARARG
;_wcsnicmp PROTO C :VARARG
_wcsnset PROTO C :VARARG
;_wcsrev PROTO C :VARARG
_wcsset PROTO C :VARARG
_wcsupr PROTO C :VARARG
_winmajor_dll PROTO C :VARARG
_winminor_dll PROTO C :VARARG
_winver_dll PROTO C :VARARG
_write PROTO C :VARARG
;_wtoi PROTO C :VARARG
;_wtol PROTO C :VARARG
_y0 PROTO C :VARARG
_y1 PROTO C :VARARG
_yn PROTO C :VARARG
;abort PROTO C :VARARG
;abs PROTO C :VARARG
acos PROTO C :VARARG
asctime PROTO C :VARARG
asin PROTO C :VARARG
atan PROTO C :VARARG
atan2 PROTO C :VARARG
;atexit PROTO C :VARARG
;atof PROTO C :VARARG
;atoi PROTO C :VARARG
;atol PROTO C :VARARG
;bsearch PROTO C :VARARG
;calloc PROTO C :VARARG
ceil PROTO C :VARARG
clearerr PROTO C :VARARG
clock PROTO C :VARARG
cos PROTO C :VARARG
cosh PROTO C :VARARG
ctime PROTO C :VARARG
difftime PROTO C :VARARG
_div PROTO C :VARARG
;exit PROTO C :VARARG
exp PROTO C :VARARG
_fabs PROTO C :VARARG
fclose PROTO C :VARARG
feof PROTO C :VARARG
ferror PROTO C :VARARG
fflush PROTO C :VARARG
fgetc PROTO C :VARARG
fgetpos PROTO C :VARARG
fgets PROTO C :VARARG
fgetwc PROTO C :VARARG
floor PROTO C :VARARG
fmod PROTO C :VARARG
fopen PROTO C :VARARG
fprintf PROTO C :VARARG
fputc PROTO C :VARARG
fputs PROTO C :VARARG
fputwc PROTO C :VARARG
fread PROTO C :VARARG
;free PROTO C :VARARG
freopen PROTO C :VARARG
frexp PROTO C :VARARG
fscanf PROTO C :VARARG
fseek PROTO C :VARARG
fsetpos PROTO C :VARARG
ftell PROTO C :VARARG
fwprintf PROTO C :VARARG
fwrite PROTO C :VARARG
fwscanf PROTO C :VARARG
getc PROTO C :VARARG
getchar PROTO C :VARARG
;getenv PROTO C :VARARG
gets PROTO C :VARARG
gmtime PROTO C :VARARG
;is_wctype PROTO C :VARARG
;isalnum PROTO C :VARARG
;isalpha PROTO C :VARARG
;iscntrl PROTO C :VARARG
;isdigit PROTO C :VARARG
;isgraph PROTO C :VARARG
;isleadbyte PROTO C :VARARG
;islower PROTO C :VARARG
;isprint PROTO C :VARARG
;ispunct PROTO C :VARARG
;isspace PROTO C :VARARG
;isupper PROTO C :VARARG
;iswalnum PROTO C :VARARG
;iswalpha PROTO C :VARARG
;iswascii PROTO C :VARARG
;iswcntrl PROTO C :VARARG
;iswctype PROTO C :VARARG
;iswdigit PROTO C :VARARG
;iswgraph PROTO C :VARARG
;iswlower PROTO C :VARARG
;iswprint PROTO C :VARARG
;iswpunct PROTO C :VARARG
;iswspace PROTO C :VARARG
;iswupper PROTO C :VARARG
;iswxdigit PROTO C :VARARG
;isxdigit PROTO C :VARARG
;labs PROTO C :VARARG
ldexp PROTO C :VARARG
;ldiv PROTO C :VARARG
localeconv PROTO C :VARARG
localtime PROTO C :VARARG
log PROTO C :VARARG
log10 PROTO C :VARARG
longjmp PROTO C :VARARG
;malloc PROTO C :VARARG
;mblen PROTO C :VARARG
mbstowcs PROTO C :VARARG
;mbtowc PROTO C :VARARG
;memchr PROTO C :VARARG
;memcmp PROTO C :VARARG
;memcpy PROTO C :VARARG
;memmove PROTO C :VARARG
;memset PROTO C :VARARG
mktime PROTO C :VARARG
modf PROTO C :VARARG
;perror PROTO C :VARARG
pow PROTO C :VARARG
printf PROTO C :VARARG
putc PROTO C :VARARG
putchar PROTO C :VARARG
puts PROTO C :VARARG
;qsort PROTO C :VARARG
raise PROTO C :VARARG
;rand PROTO C :VARARG
;realloc PROTO C :VARARG
remove PROTO C :VARARG
rename PROTO C :VARARG
rewind PROTO C :VARARG
scanf PROTO C :VARARG
setbuf PROTO C :VARARG
setlocale PROTO C :VARARG
setvbuf PROTO C :VARARG
signal PROTO C :VARARG
sin PROTO C :VARARG
sinh PROTO C :VARARG
sprintf PROTO C :VARARG
sqrt PROTO C :VARARG
;srand PROTO C :VARARG
sscanf PROTO C :VARARG
strcat PROTO C :VARARG
;strchr PROTO C :VARARG
;strcmp PROTO C :VARARG
;strcoll PROTO C :VARARG
strcpy PROTO C :VARARG
;strcspn PROTO C :VARARG
;strerror PROTO C :VARARG
strftime PROTO C :VARARG
;strlen PROTO C :VARARG
strncat PROTO C :VARARG
;strncmp PROTO C :VARARG
strncpy PROTO C :VARARG
;strpbrk PROTO C :VARARG
;strrchr PROTO C :VARARG
;strspn PROTO C :VARARG
;strstr PROTO C :VARARG
;strtod PROTO C :VARARG
;strtok PROTO C :VARARG
;strtol PROTO C :VARARG
;strtoul PROTO C :VARARG
;strxfrm PROTO C :VARARG
swprintf PROTO C :VARARG
swscanf PROTO C :VARARG
;system PROTO C :VARARG
tan PROTO C :VARARG
tanh PROTO C :VARARG
time PROTO C :VARARG
tmpfile PROTO C :VARARG
tmpnam PROTO C :VARARG
;tolower PROTO C :VARARG
;toupper PROTO C :VARARG
;towlower PROTO C :VARARG
;towupper PROTO C :VARARG
ungetc PROTO C :VARARG
ungetwc PROTO C :VARARG
vfprintf PROTO C :VARARG
vfwprintf PROTO C :VARARG
vprintf PROTO C :VARARG
vsprintf PROTO C :VARARG
vswprintf PROTO C :VARARG
vwprintf PROTO C :VARARG
wcscat PROTO C :VARARG
;wcschr PROTO C :VARARG
;wcscmp PROTO C :VARARG
;wcscoll PROTO C :VARARG
wcscpy PROTO C :VARARG
;wcscspn PROTO C :VARARG
wcsftime PROTO C :VARARG
;wcslen PROTO C :VARARG
wcsncat PROTO C :VARARG
;wcsncmp PROTO C :VARARG
wcsncpy PROTO C :VARARG
;wcspbrk PROTO C :VARARG
;wcsrchr PROTO C :VARARG
;wcsspn PROTO C :VARARG
;wcsstr PROTO C :VARARG
;wcstod PROTO C :VARARG
;wcstok PROTO C :VARARG
;wcstol PROTO C :VARARG
wcstombs PROTO C :VARARG
;wcstoul PROTO C :VARARG
;wcsxfrm PROTO C :VARARG
;wctomb PROTO C :VARARG
wprintf PROTO C :VARARG
wscanf PROTO C :VARARG
