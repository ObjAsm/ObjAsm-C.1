
;--- Generated .INC file by COMView
;--- typelib name=MSFormsc
;--- documentation=Microsoft Forms 2.0 Object Library
;--- GUID={0D452EE1-E08F-101A-852E-02608C4D0BB4}
;--- Version 2.0, LCID 0

;--- prototypes too complex for MASM may exist
;--- if such ones reside in a vtable they will be replaced by dummies
;--- search for occurances of ';+++' to have a closer look at these

;--- here dispatchonly interfaces are described
;--- whose methods/properties can be accessed thru IDispatch::Invoke only
;--- use macro dm() to call a method/property of such an interface.
;--- macro dm(), which is described in file objbase.inc,
;--- requires placing macro DEFINE_INVOKEHELPER somewhere in your source code

;--- MdcListEvents, Type=DISPATCH, GUID={8BD21D22-EC42-11CE-9E0D-00AA006002F3}

  DEFINE_COM_DISP_METHOD  MdcListEvents , BeforeDragOver, 03h, METHOD, , VT_BYREF OR VT_USERDEFINED,VT_BYREF OR VT_USERDEFINED,VT_R4,VT_R4,VT_USERDEFINED,VT_BYREF OR VT_USERDEFINED,VT_I2
  DEFINE_COM_DISP_METHOD  MdcListEvents , BeforeDropOrPaste, 04h, METHOD, , VT_BYREF OR VT_USERDEFINED,VT_USERDEFINED,VT_BYREF OR VT_USERDEFINED,VT_R4,VT_R4,VT_BYREF OR VT_USERDEFINED,VT_I2
  DEFINE_COM_DISP_METHOD  MdcListEvents , Change, 02h, METHOD, 
  DEFINE_COM_DISP_METHOD  MdcListEvents , Click, 0FFFFFD9Eh, METHOD, 
  DEFINE_COM_DISP_METHOD  MdcListEvents , DblClick, 0FFFFFDA7h, METHOD, , VT_BYREF OR VT_USERDEFINED
  DEFINE_COM_DISP_METHOD  MdcListEvents , Error, 0FFFFFDA0h, METHOD, , VT_I2,VT_BYREF OR VT_USERDEFINED,VT_I4,VT_BSTR,VT_BSTR,VT_I4,VT_BYREF OR VT_USERDEFINED
  DEFINE_COM_DISP_METHOD  MdcListEvents , KeyDown, 0FFFFFDA6h, METHOD, , VT_BYREF OR VT_USERDEFINED,VT_I2
  DEFINE_COM_DISP_METHOD  MdcListEvents , KeyPress, 0FFFFFDA5h, METHOD, , VT_BYREF OR VT_USERDEFINED
  DEFINE_COM_DISP_METHOD  MdcListEvents , KeyUp, 0FFFFFDA4h, METHOD, , VT_BYREF OR VT_USERDEFINED,VT_I2
  DEFINE_COM_DISP_METHOD  MdcListEvents , MouseDown, 0FFFFFDA3h, METHOD, , VT_I2,VT_I2,VT_R4,VT_R4
  DEFINE_COM_DISP_METHOD  MdcListEvents , MouseMove, 0FFFFFDA2h, METHOD, , VT_I2,VT_I2,VT_R4,VT_R4
  DEFINE_COM_DISP_METHOD  MdcListEvents , MouseUp, 0FFFFFDA1h, METHOD, , VT_I2,VT_I2,VT_R4,VT_R4

;--- MdcComboEvents, Type=DISPATCH, GUID={8BD21D32-EC42-11CE-9E0D-00AA006002F3}

  DEFINE_COM_DISP_METHOD  MdcComboEvents , BeforeDragOver, 03h, METHOD, , VT_BYREF OR VT_USERDEFINED,VT_BYREF OR VT_USERDEFINED,VT_R4,VT_R4,VT_USERDEFINED,VT_BYREF OR VT_USERDEFINED,VT_I2
  DEFINE_COM_DISP_METHOD  MdcComboEvents , BeforeDropOrPaste, 04h, METHOD, , VT_BYREF OR VT_USERDEFINED,VT_USERDEFINED,VT_BYREF OR VT_USERDEFINED,VT_R4,VT_R4,VT_BYREF OR VT_USERDEFINED,VT_I2
  DEFINE_COM_DISP_METHOD  MdcComboEvents , Change, 02h, METHOD, 
  DEFINE_COM_DISP_METHOD  MdcComboEvents , Click, 0FFFFFD9Eh, METHOD, 
  DEFINE_COM_DISP_METHOD  MdcComboEvents , DblClick, 0FFFFFDA7h, METHOD, , VT_BYREF OR VT_USERDEFINED
  DEFINE_COM_DISP_METHOD  MdcComboEvents , DropButtonClick, 07D2h, METHOD, 
  DEFINE_COM_DISP_METHOD  MdcComboEvents , Error, 0FFFFFDA0h, METHOD, , VT_I2,VT_BYREF OR VT_USERDEFINED,VT_I4,VT_BSTR,VT_BSTR,VT_I4,VT_BYREF OR VT_USERDEFINED
  DEFINE_COM_DISP_METHOD  MdcComboEvents , KeyDown, 0FFFFFDA6h, METHOD, , VT_BYREF OR VT_USERDEFINED,VT_I2
  DEFINE_COM_DISP_METHOD  MdcComboEvents , KeyPress, 0FFFFFDA5h, METHOD, , VT_BYREF OR VT_USERDEFINED
  DEFINE_COM_DISP_METHOD  MdcComboEvents , KeyUp, 0FFFFFDA4h, METHOD, , VT_BYREF OR VT_USERDEFINED,VT_I2
  DEFINE_COM_DISP_METHOD  MdcComboEvents , MouseDown, 0FFFFFDA3h, METHOD, , VT_I2,VT_I2,VT_R4,VT_R4
  DEFINE_COM_DISP_METHOD  MdcComboEvents , MouseMove, 0FFFFFDA2h, METHOD, , VT_I2,VT_I2,VT_R4,VT_R4
  DEFINE_COM_DISP_METHOD  MdcComboEvents , MouseUp, 0FFFFFDA1h, METHOD, , VT_I2,VT_I2,VT_R4,VT_R4

;--- MdcCheckBoxEvents, Type=DISPATCH, GUID={8BD21D42-EC42-11CE-9E0D-00AA006002F3}

  DEFINE_COM_DISP_METHOD  MdcCheckBoxEvents , BeforeDragOver, 03h, METHOD, , VT_BYREF OR VT_USERDEFINED,VT_BYREF OR VT_USERDEFINED,VT_R4,VT_R4,VT_USERDEFINED,VT_BYREF OR VT_USERDEFINED,VT_I2
  DEFINE_COM_DISP_METHOD  MdcCheckBoxEvents , BeforeDropOrPaste, 04h, METHOD, , VT_BYREF OR VT_USERDEFINED,VT_USERDEFINED,VT_BYREF OR VT_USERDEFINED,VT_R4,VT_R4,VT_BYREF OR VT_USERDEFINED,VT_I2
  DEFINE_COM_DISP_METHOD  MdcCheckBoxEvents , Change, 02h, METHOD, 
  DEFINE_COM_DISP_METHOD  MdcCheckBoxEvents , Click, 0FFFFFD9Eh, METHOD, 
  DEFINE_COM_DISP_METHOD  MdcCheckBoxEvents , DblClick, 0FFFFFDA7h, METHOD, , VT_BYREF OR VT_USERDEFINED
  DEFINE_COM_DISP_METHOD  MdcCheckBoxEvents , Error, 0FFFFFDA0h, METHOD, , VT_I2,VT_BYREF OR VT_USERDEFINED,VT_I4,VT_BSTR,VT_BSTR,VT_I4,VT_BYREF OR VT_USERDEFINED
  DEFINE_COM_DISP_METHOD  MdcCheckBoxEvents , KeyDown, 0FFFFFDA6h, METHOD, , VT_BYREF OR VT_USERDEFINED,VT_I2
  DEFINE_COM_DISP_METHOD  MdcCheckBoxEvents , KeyPress, 0FFFFFDA5h, METHOD, , VT_BYREF OR VT_USERDEFINED
  DEFINE_COM_DISP_METHOD  MdcCheckBoxEvents , KeyUp, 0FFFFFDA4h, METHOD, , VT_BYREF OR VT_USERDEFINED,VT_I2
  DEFINE_COM_DISP_METHOD  MdcCheckBoxEvents , MouseDown, 0FFFFFDA3h, METHOD, , VT_I2,VT_I2,VT_R4,VT_R4
  DEFINE_COM_DISP_METHOD  MdcCheckBoxEvents , MouseMove, 0FFFFFDA2h, METHOD, , VT_I2,VT_I2,VT_R4,VT_R4
  DEFINE_COM_DISP_METHOD  MdcCheckBoxEvents , MouseUp, 0FFFFFDA1h, METHOD, , VT_I2,VT_I2,VT_R4,VT_R4

;--- MdcOptionButtonEvents, Type=DISPATCH, GUID={8BD21D52-EC42-11CE-9E0D-00AA006002F3}

  DEFINE_COM_DISP_METHOD  MdcOptionButtonEvents , BeforeDragOver, 03h, METHOD, , VT_BYREF OR VT_USERDEFINED,VT_BYREF OR VT_USERDEFINED,VT_R4,VT_R4,VT_USERDEFINED,VT_BYREF OR VT_USERDEFINED,VT_I2
  DEFINE_COM_DISP_METHOD  MdcOptionButtonEvents , BeforeDropOrPaste, 04h, METHOD, , VT_BYREF OR VT_USERDEFINED,VT_USERDEFINED,VT_BYREF OR VT_USERDEFINED,VT_R4,VT_R4,VT_BYREF OR VT_USERDEFINED,VT_I2
  DEFINE_COM_DISP_METHOD  MdcOptionButtonEvents , Change, 02h, METHOD, 
  DEFINE_COM_DISP_METHOD  MdcOptionButtonEvents , Click, 0FFFFFD9Eh, METHOD, 
  DEFINE_COM_DISP_METHOD  MdcOptionButtonEvents , DblClick, 0FFFFFDA7h, METHOD, , VT_BYREF OR VT_USERDEFINED
  DEFINE_COM_DISP_METHOD  MdcOptionButtonEvents , Error, 0FFFFFDA0h, METHOD, , VT_I2,VT_BYREF OR VT_USERDEFINED,VT_I4,VT_BSTR,VT_BSTR,VT_I4,VT_BYREF OR VT_USERDEFINED
  DEFINE_COM_DISP_METHOD  MdcOptionButtonEvents , KeyDown, 0FFFFFDA6h, METHOD, , VT_BYREF OR VT_USERDEFINED,VT_I2
  DEFINE_COM_DISP_METHOD  MdcOptionButtonEvents , KeyPress, 0FFFFFDA5h, METHOD, , VT_BYREF OR VT_USERDEFINED
  DEFINE_COM_DISP_METHOD  MdcOptionButtonEvents , KeyUp, 0FFFFFDA4h, METHOD, , VT_BYREF OR VT_USERDEFINED,VT_I2
  DEFINE_COM_DISP_METHOD  MdcOptionButtonEvents , MouseDown, 0FFFFFDA3h, METHOD, , VT_I2,VT_I2,VT_R4,VT_R4
  DEFINE_COM_DISP_METHOD  MdcOptionButtonEvents , MouseMove, 0FFFFFDA2h, METHOD, , VT_I2,VT_I2,VT_R4,VT_R4
  DEFINE_COM_DISP_METHOD  MdcOptionButtonEvents , MouseUp, 0FFFFFDA1h, METHOD, , VT_I2,VT_I2,VT_R4,VT_R4

;--- MdcToggleButtonEvents, Type=DISPATCH, GUID={8BD21D62-EC42-11CE-9E0D-00AA006002F3}

  DEFINE_COM_DISP_METHOD  MdcToggleButtonEvents , BeforeDragOver, 03h, METHOD, , VT_BYREF OR VT_USERDEFINED,VT_BYREF OR VT_USERDEFINED,VT_R4,VT_R4,VT_USERDEFINED,VT_BYREF OR VT_USERDEFINED,VT_I2
  DEFINE_COM_DISP_METHOD  MdcToggleButtonEvents , BeforeDropOrPaste, 04h, METHOD, , VT_BYREF OR VT_USERDEFINED,VT_USERDEFINED,VT_BYREF OR VT_USERDEFINED,VT_R4,VT_R4,VT_BYREF OR VT_USERDEFINED,VT_I2
  DEFINE_COM_DISP_METHOD  MdcToggleButtonEvents , Change, 02h, METHOD, 
  DEFINE_COM_DISP_METHOD  MdcToggleButtonEvents , Click, 0FFFFFD9Eh, METHOD, 
  DEFINE_COM_DISP_METHOD  MdcToggleButtonEvents , DblClick, 0FFFFFDA7h, METHOD, , VT_BYREF OR VT_USERDEFINED
  DEFINE_COM_DISP_METHOD  MdcToggleButtonEvents , Error, 0FFFFFDA0h, METHOD, , VT_I2,VT_BYREF OR VT_USERDEFINED,VT_I4,VT_BSTR,VT_BSTR,VT_I4,VT_BYREF OR VT_USERDEFINED
  DEFINE_COM_DISP_METHOD  MdcToggleButtonEvents , KeyDown, 0FFFFFDA6h, METHOD, , VT_BYREF OR VT_USERDEFINED,VT_I2
  DEFINE_COM_DISP_METHOD  MdcToggleButtonEvents , KeyPress, 0FFFFFDA5h, METHOD, , VT_BYREF OR VT_USERDEFINED
  DEFINE_COM_DISP_METHOD  MdcToggleButtonEvents , KeyUp, 0FFFFFDA4h, METHOD, , VT_BYREF OR VT_USERDEFINED,VT_I2
  DEFINE_COM_DISP_METHOD  MdcToggleButtonEvents , MouseDown, 0FFFFFDA3h, METHOD, , VT_I2,VT_I2,VT_R4,VT_R4
  DEFINE_COM_DISP_METHOD  MdcToggleButtonEvents , MouseMove, 0FFFFFDA2h, METHOD, , VT_I2,VT_I2,VT_R4,VT_R4
  DEFINE_COM_DISP_METHOD  MdcToggleButtonEvents , MouseUp, 0FFFFFDA1h, METHOD, , VT_I2,VT_I2,VT_R4,VT_R4

;--- ScrollbarEvents, Type=DISPATCH, GUID={7B020EC2-AF6C-11CE-9F46-00AA00574A4F}

  DEFINE_COM_DISP_METHOD  ScrollbarEvents , BeforeDragOver, 03h, METHOD, , VT_BYREF OR VT_USERDEFINED,VT_BYREF OR VT_USERDEFINED,VT_R4,VT_R4,VT_USERDEFINED,VT_BYREF OR VT_USERDEFINED,VT_I2
  DEFINE_COM_DISP_METHOD  ScrollbarEvents , BeforeDropOrPaste, 04h, METHOD, , VT_BYREF OR VT_USERDEFINED,VT_USERDEFINED,VT_BYREF OR VT_USERDEFINED,VT_R4,VT_R4,VT_BYREF OR VT_USERDEFINED,VT_I2
  DEFINE_COM_DISP_METHOD  ScrollbarEvents , Change, 02h, METHOD, 
  DEFINE_COM_DISP_METHOD  ScrollbarEvents , Error, 0FFFFFDA0h, METHOD, , VT_I2,VT_BYREF OR VT_USERDEFINED,VT_I4,VT_BSTR,VT_BSTR,VT_I4,VT_BYREF OR VT_USERDEFINED
  DEFINE_COM_DISP_METHOD  ScrollbarEvents , KeyDown, 0FFFFFDA6h, METHOD, , VT_BYREF OR VT_USERDEFINED,VT_I2
  DEFINE_COM_DISP_METHOD  ScrollbarEvents , KeyPress, 0FFFFFDA5h, METHOD, , VT_BYREF OR VT_USERDEFINED
  DEFINE_COM_DISP_METHOD  ScrollbarEvents , KeyUp, 0FFFFFDA4h, METHOD, , VT_BYREF OR VT_USERDEFINED,VT_I2
  DEFINE_COM_DISP_METHOD  ScrollbarEvents , Scroll, 07h, METHOD, 

;--- TabStripEvents, Type=DISPATCH, GUID={7B020EC7-AF6C-11CE-9F46-00AA00574A4F}

  DEFINE_COM_DISP_METHOD  TabStripEvents , BeforeDragOver, 03h, METHOD, , VT_I4,VT_BYREF OR VT_USERDEFINED,VT_BYREF OR VT_USERDEFINED,VT_R4,VT_R4,VT_USERDEFINED,VT_BYREF OR VT_USERDEFINED,VT_I2
  DEFINE_COM_DISP_METHOD  TabStripEvents , BeforeDropOrPaste, 04h, METHOD, , VT_I4,VT_BYREF OR VT_USERDEFINED,VT_USERDEFINED,VT_BYREF OR VT_USERDEFINED,VT_R4,VT_R4,VT_BYREF OR VT_USERDEFINED,VT_I2
  DEFINE_COM_DISP_METHOD  TabStripEvents , Change, 02h, METHOD, 
  DEFINE_COM_DISP_METHOD  TabStripEvents , Click, 0FFFFFDA8h, METHOD, , VT_I4
  DEFINE_COM_DISP_METHOD  TabStripEvents , DblClick, 0FFFFFDA7h, METHOD, , VT_I4,VT_BYREF OR VT_USERDEFINED
  DEFINE_COM_DISP_METHOD  TabStripEvents , Error, 0FFFFFDA0h, METHOD, , VT_I2,VT_BYREF OR VT_USERDEFINED,VT_I4,VT_BSTR,VT_BSTR,VT_I4,VT_BYREF OR VT_USERDEFINED
  DEFINE_COM_DISP_METHOD  TabStripEvents , KeyDown, 0FFFFFDA6h, METHOD, , VT_BYREF OR VT_USERDEFINED,VT_I2
  DEFINE_COM_DISP_METHOD  TabStripEvents , KeyPress, 0FFFFFDA5h, METHOD, , VT_BYREF OR VT_USERDEFINED
  DEFINE_COM_DISP_METHOD  TabStripEvents , KeyUp, 0FFFFFDA4h, METHOD, , VT_BYREF OR VT_USERDEFINED,VT_I2
  DEFINE_COM_DISP_METHOD  TabStripEvents , MouseDown, 0FFFFFDA3h, METHOD, , VT_I4,VT_I2,VT_I2,VT_R4,VT_R4
  DEFINE_COM_DISP_METHOD  TabStripEvents , MouseMove, 0FFFFFDA2h, METHOD, , VT_I4,VT_I2,VT_I2,VT_R4,VT_R4
  DEFINE_COM_DISP_METHOD  TabStripEvents , MouseUp, 0FFFFFDA1h, METHOD, , VT_I4,VT_I2,VT_I2,VT_R4,VT_R4

;--- SpinbuttonEvents, Type=DISPATCH, GUID={79176FB2-B7F2-11CE-97EF-00AA006D2776}

  DEFINE_COM_DISP_METHOD  SpinbuttonEvents , BeforeDragOver, 03h, METHOD, , VT_BYREF OR VT_USERDEFINED,VT_BYREF OR VT_USERDEFINED,VT_R4,VT_R4,VT_USERDEFINED,VT_BYREF OR VT_USERDEFINED,VT_I2
  DEFINE_COM_DISP_METHOD  SpinbuttonEvents , BeforeDropOrPaste, 04h, METHOD, , VT_BYREF OR VT_USERDEFINED,VT_USERDEFINED,VT_BYREF OR VT_USERDEFINED,VT_R4,VT_R4,VT_BYREF OR VT_USERDEFINED,VT_I2
  DEFINE_COM_DISP_METHOD  SpinbuttonEvents , Change, 02h, METHOD, 
  DEFINE_COM_DISP_METHOD  SpinbuttonEvents , Error, 0FFFFFDA0h, METHOD, , VT_I2,VT_BYREF OR VT_USERDEFINED,VT_I4,VT_BSTR,VT_BSTR,VT_I4,VT_BYREF OR VT_USERDEFINED
  DEFINE_COM_DISP_METHOD  SpinbuttonEvents , KeyDown, 0FFFFFDA6h, METHOD, , VT_BYREF OR VT_USERDEFINED,VT_I2
  DEFINE_COM_DISP_METHOD  SpinbuttonEvents , KeyPress, 0FFFFFDA5h, METHOD, , VT_BYREF OR VT_USERDEFINED
  DEFINE_COM_DISP_METHOD  SpinbuttonEvents , KeyUp, 0FFFFFDA4h, METHOD, , VT_BYREF OR VT_USERDEFINED,VT_I2
  DEFINE_COM_DISP_METHOD  SpinbuttonEvents , SpinUp, 05h, METHOD, 
  DEFINE_COM_DISP_METHOD  SpinbuttonEvents , SpinDown, 06h, METHOD, 

;--- ImageEvents, Type=DISPATCH, GUID={4C5992A5-6926-101B-9992-00000B65C6F9}

  DEFINE_COM_DISP_METHOD  ImageEvents , BeforeDragOver, 03h, METHOD, , VT_BYREF OR VT_USERDEFINED,VT_BYREF OR VT_USERDEFINED,VT_R4,VT_R4,VT_USERDEFINED,VT_BYREF OR VT_USERDEFINED,VT_I2
  DEFINE_COM_DISP_METHOD  ImageEvents , BeforeDropOrPaste, 04h, METHOD, , VT_BYREF OR VT_USERDEFINED,VT_USERDEFINED,VT_BYREF OR VT_USERDEFINED,VT_R4,VT_R4,VT_BYREF OR VT_USERDEFINED,VT_I2
  DEFINE_COM_DISP_METHOD  ImageEvents , Click, 0FFFFFDA8h, METHOD, 
  DEFINE_COM_DISP_METHOD  ImageEvents , DblClick, 0FFFFFDA7h, METHOD, , VT_BYREF OR VT_USERDEFINED
  DEFINE_COM_DISP_METHOD  ImageEvents , Error, 0FFFFFDA0h, METHOD, , VT_I2,VT_BYREF OR VT_USERDEFINED,VT_I4,VT_BSTR,VT_BSTR,VT_I4,VT_BYREF OR VT_USERDEFINED
  DEFINE_COM_DISP_METHOD  ImageEvents , MouseDown, 0FFFFFDA3h, METHOD, , VT_I2,VT_I2,VT_R4,VT_R4
  DEFINE_COM_DISP_METHOD  ImageEvents , MouseMove, 0FFFFFDA2h, METHOD, , VT_I2,VT_I2,VT_R4,VT_R4
  DEFINE_COM_DISP_METHOD  ImageEvents , MouseUp, 0FFFFFDA1h, METHOD, , VT_I2,VT_I2,VT_R4,VT_R4

;--- WHTMLControlEvents, Type=DISPATCH, GUID={796ED650-5FE9-11CF-8D68-00AA00BDCE1D}

  DEFINE_COM_DISP_METHOD  WHTMLControlEvents , Click, 0FFFFFDA8h, METHOD, 

;--- WHTMLControlEvents1, Type=DISPATCH, GUID={47FF8FE0-6198-11CF-8CE8-00AA006CB389}

  DEFINE_COM_DISP_METHOD  WHTMLControlEvents1 , Click, 0FFFFFDA8h, METHOD, 

;--- WHTMLControlEvents2, Type=DISPATCH, GUID={47FF8FE1-6198-11CF-8CE8-00AA006CB389}

  DEFINE_COM_DISP_METHOD  WHTMLControlEvents2 , Click, 0FFFFFDA8h, METHOD, 

;--- WHTMLControlEvents3, Type=DISPATCH, GUID={47FF8FE2-6198-11CF-8CE8-00AA006CB389}

  DEFINE_COM_DISP_METHOD  WHTMLControlEvents3 , Click, 0FFFFFDA8h, METHOD, 

;--- WHTMLControlEvents4, Type=DISPATCH, GUID={47FF8FE3-6198-11CF-8CE8-00AA006CB389}

  DEFINE_COM_DISP_METHOD  WHTMLControlEvents4 , Click, 0FFFFFDA8h, METHOD, 

;--- WHTMLControlEvents5, Type=DISPATCH, GUID={47FF8FE4-6198-11CF-8CE8-00AA006CB389}

  DEFINE_COM_DISP_METHOD  WHTMLControlEvents5 , Click, 0FFFFFDA8h, METHOD, 

;--- WHTMLControlEvents6, Type=DISPATCH, GUID={47FF8FE5-6198-11CF-8CE8-00AA006CB389}

  DEFINE_COM_DISP_METHOD  WHTMLControlEvents6 , Click, 0FFFFFDA8h, METHOD, 

;--- WHTMLControlEvents7, Type=DISPATCH, GUID={47FF8FE6-6198-11CF-8CE8-00AA006CB389}

  DEFINE_COM_DISP_METHOD  WHTMLControlEvents7 , Click, 0FFFFFDA8h, METHOD, 

;--- WHTMLControlEvents9, Type=DISPATCH, GUID={47FF8FE8-6198-11CF-8CE8-00AA006CB389}

  DEFINE_COM_DISP_METHOD  WHTMLControlEvents9 , Click, 0FFFFFDA8h, METHOD, 

;--- WHTMLControlEvents10, Type=DISPATCH, GUID={47FF8FE9-6198-11CF-8CE8-00AA006CB389}

  DEFINE_COM_DISP_METHOD  WHTMLControlEvents10 , Click, 0FFFFFDA8h, METHOD, 

;--- FormEvents, Type=DISPATCH, GUID={5B9D8FC8-4A71-101B-97A6-00000B65C08B}

  DEFINE_COM_DISP_METHOD  FormEvents , AddControl, 0300h, METHOD, , VT_BYREF OR VT_USERDEFINED
  DEFINE_COM_DISP_METHOD  FormEvents , BeforeDragOver, 03h, METHOD, , VT_BYREF OR VT_USERDEFINED,VT_BYREF OR VT_USERDEFINED,VT_BYREF OR VT_USERDEFINED,VT_R4,VT_R4,VT_USERDEFINED,VT_BYREF OR VT_USERDEFINED,VT_I2
  DEFINE_COM_DISP_METHOD  FormEvents , BeforeDropOrPaste, 04h, METHOD, , VT_BYREF OR VT_USERDEFINED,VT_BYREF OR VT_USERDEFINED,VT_USERDEFINED,VT_BYREF OR VT_USERDEFINED,VT_R4,VT_R4,VT_BYREF OR VT_USERDEFINED,VT_I2
  DEFINE_COM_DISP_METHOD  FormEvents , Click, 0FFFFFDA8h, METHOD, 
  DEFINE_COM_DISP_METHOD  FormEvents , DblClick, 0FFFFFDA7h, METHOD, , VT_BYREF OR VT_USERDEFINED
  DEFINE_COM_DISP_METHOD  FormEvents , Error, 0FFFFFDA0h, METHOD, , VT_I2,VT_BYREF OR VT_USERDEFINED,VT_I4,VT_BSTR,VT_BSTR,VT_I4,VT_BYREF OR VT_USERDEFINED
  DEFINE_COM_DISP_METHOD  FormEvents , KeyDown, 0FFFFFDA6h, METHOD, , VT_BYREF OR VT_USERDEFINED,VT_I2
  DEFINE_COM_DISP_METHOD  FormEvents , KeyPress, 0FFFFFDA5h, METHOD, , VT_BYREF OR VT_USERDEFINED
  DEFINE_COM_DISP_METHOD  FormEvents , KeyUp, 0FFFFFDA4h, METHOD, , VT_BYREF OR VT_USERDEFINED,VT_I2
  DEFINE_COM_DISP_METHOD  FormEvents , Layout, 0302h, METHOD, 
  DEFINE_COM_DISP_METHOD  FormEvents , MouseDown, 0FFFFFDA3h, METHOD, , VT_I2,VT_I2,VT_R4,VT_R4
  DEFINE_COM_DISP_METHOD  FormEvents , MouseMove, 0FFFFFDA2h, METHOD, , VT_I2,VT_I2,VT_R4,VT_R4
  DEFINE_COM_DISP_METHOD  FormEvents , MouseUp, 0FFFFFDA1h, METHOD, , VT_I2,VT_I2,VT_R4,VT_R4
  DEFINE_COM_DISP_METHOD  FormEvents , RemoveControl, 0303h, METHOD, , VT_BYREF OR VT_USERDEFINED
  DEFINE_COM_DISP_METHOD  FormEvents , Scroll, 0304h, METHOD, , VT_USERDEFINED,VT_USERDEFINED,VT_R4,VT_R4,VT_BYREF OR VT_USERDEFINED,VT_BYREF OR VT_USERDEFINED
  DEFINE_COM_DISP_METHOD  FormEvents , Zoom, 0305h, METHOD, , VT_BYREF OR VT_I2

;--- OptionFrameEvents, Type=DISPATCH, GUID={CF3F94A0-F546-11CE-9BCE-00AA00608E01}

  DEFINE_COM_DISP_METHOD  OptionFrameEvents , AddControl, 0300h, METHOD, , VT_BYREF OR VT_USERDEFINED
  DEFINE_COM_DISP_METHOD  OptionFrameEvents , BeforeDragOver, 03h, METHOD, , VT_BYREF OR VT_USERDEFINED,VT_BYREF OR VT_USERDEFINED,VT_BYREF OR VT_USERDEFINED,VT_R4,VT_R4,VT_USERDEFINED,VT_BYREF OR VT_USERDEFINED,VT_I2
  DEFINE_COM_DISP_METHOD  OptionFrameEvents , BeforeDropOrPaste, 04h, METHOD, , VT_BYREF OR VT_USERDEFINED,VT_BYREF OR VT_USERDEFINED,VT_USERDEFINED,VT_BYREF OR VT_USERDEFINED,VT_R4,VT_R4,VT_BYREF OR VT_USERDEFINED,VT_I2
  DEFINE_COM_DISP_METHOD  OptionFrameEvents , Click, 0FFFFFDA8h, METHOD, 
  DEFINE_COM_DISP_METHOD  OptionFrameEvents , DblClick, 0FFFFFDA7h, METHOD, , VT_BYREF OR VT_USERDEFINED
  DEFINE_COM_DISP_METHOD  OptionFrameEvents , Error, 0FFFFFDA0h, METHOD, , VT_I2,VT_BYREF OR VT_USERDEFINED,VT_I4,VT_BSTR,VT_BSTR,VT_I4,VT_BYREF OR VT_USERDEFINED
  DEFINE_COM_DISP_METHOD  OptionFrameEvents , KeyDown, 0FFFFFDA6h, METHOD, , VT_BYREF OR VT_USERDEFINED,VT_I2
  DEFINE_COM_DISP_METHOD  OptionFrameEvents , KeyPress, 0FFFFFDA5h, METHOD, , VT_BYREF OR VT_USERDEFINED
  DEFINE_COM_DISP_METHOD  OptionFrameEvents , KeyUp, 0FFFFFDA4h, METHOD, , VT_BYREF OR VT_USERDEFINED,VT_I2
  DEFINE_COM_DISP_METHOD  OptionFrameEvents , Layout, 0302h, METHOD, 
  DEFINE_COM_DISP_METHOD  OptionFrameEvents , MouseDown, 0FFFFFDA3h, METHOD, , VT_I2,VT_I2,VT_R4,VT_R4
  DEFINE_COM_DISP_METHOD  OptionFrameEvents , MouseMove, 0FFFFFDA2h, METHOD, , VT_I2,VT_I2,VT_R4,VT_R4
  DEFINE_COM_DISP_METHOD  OptionFrameEvents , MouseUp, 0FFFFFDA1h, METHOD, , VT_I2,VT_I2,VT_R4,VT_R4
  DEFINE_COM_DISP_METHOD  OptionFrameEvents , RemoveControl, 0303h, METHOD, , VT_BYREF OR VT_USERDEFINED
  DEFINE_COM_DISP_METHOD  OptionFrameEvents , Scroll, 0304h, METHOD, , VT_USERDEFINED,VT_USERDEFINED,VT_R4,VT_R4,VT_BYREF OR VT_USERDEFINED,VT_BYREF OR VT_USERDEFINED
  DEFINE_COM_DISP_METHOD  OptionFrameEvents , Zoom, 0305h, METHOD, , VT_BYREF OR VT_I2

;--- Font, Type=DISPATCH, GUID={BEF6E003-A874-101A-8BBA-00AA00300CAB}

  DEFINE_COM_DISP_METHOD  Font , get_Name, 00h, PROPERTYGET, VT_BSTR
  DEFINE_COM_DISP_METHOD  Font , put_Name, 00h, PROPERTYPUT, , VT_BSTR
  DEFINE_COM_DISP_METHOD  Font , get_Size, 02h, PROPERTYGET, VT_CY
  DEFINE_COM_DISP_METHOD  Font , put_Size, 02h, PROPERTYPUT, , VT_CY
  DEFINE_COM_DISP_METHOD  Font , get_Bold, 03h, PROPERTYGET, VT_BOOL
  DEFINE_COM_DISP_METHOD  Font , put_Bold, 03h, PROPERTYPUT, , VT_BOOL
  DEFINE_COM_DISP_METHOD  Font , get_Italic, 04h, PROPERTYGET, VT_BOOL
  DEFINE_COM_DISP_METHOD  Font , put_Italic, 04h, PROPERTYPUT, , VT_BOOL
  DEFINE_COM_DISP_METHOD  Font , get_Underline, 05h, PROPERTYGET, VT_BOOL
  DEFINE_COM_DISP_METHOD  Font , put_Underline, 05h, PROPERTYPUT, , VT_BOOL
  DEFINE_COM_DISP_METHOD  Font , get_Strikethrough, 06h, PROPERTYGET, VT_BOOL
  DEFINE_COM_DISP_METHOD  Font , put_Strikethrough, 06h, PROPERTYPUT, , VT_BOOL
  DEFINE_COM_DISP_METHOD  Font , get_Weight, 07h, PROPERTYGET, VT_I2
  DEFINE_COM_DISP_METHOD  Font , put_Weight, 07h, PROPERTYPUT, , VT_I2
  DEFINE_COM_DISP_METHOD  Font , get_Charset, 08h, PROPERTYGET, VT_I2
  DEFINE_COM_DISP_METHOD  Font , put_Charset, 08h, PROPERTYPUT, , VT_I2


;--- ControlEvents, Type=DISPATCH, GUID={9A4BBF53-4E46-101B-8BBD-00AA003E3B29}

  DEFINE_COM_DISP_METHOD  ControlEvents , Enter_, 080018202h, METHOD, 
  DEFINE_COM_DISP_METHOD  ControlEvents , Exit, 080018203h, METHOD, , VT_BYREF OR VT_USERDEFINED
  DEFINE_COM_DISP_METHOD  ControlEvents , BeforeUpdate, 080018201h, METHOD, , VT_BYREF OR VT_USERDEFINED
  DEFINE_COM_DISP_METHOD  ControlEvents , AfterUpdate, 080018200h, METHOD, 

;--- MultiPageEvents, Type=DISPATCH, GUID={7B020EC8-AF6C-11CE-9F46-00AA00574A4F}

  DEFINE_COM_DISP_METHOD  MultiPageEvents , AddControl, 0300h, METHOD, , VT_I4,VT_BYREF OR VT_USERDEFINED
  DEFINE_COM_DISP_METHOD  MultiPageEvents , BeforeDragOver, 03h, METHOD, , VT_I4,VT_BYREF OR VT_USERDEFINED,VT_BYREF OR VT_USERDEFINED,VT_BYREF OR VT_USERDEFINED,VT_R4,VT_R4,VT_USERDEFINED,VT_BYREF OR VT_USERDEFINED,VT_I2
  DEFINE_COM_DISP_METHOD  MultiPageEvents , BeforeDropOrPaste, 04h, METHOD, , VT_I4,VT_BYREF OR VT_USERDEFINED,VT_BYREF OR VT_USERDEFINED,VT_USERDEFINED,VT_BYREF OR VT_USERDEFINED,VT_R4,VT_R4,VT_BYREF OR VT_USERDEFINED,VT_I2
  DEFINE_COM_DISP_METHOD  MultiPageEvents , Change, 02h, METHOD, 
  DEFINE_COM_DISP_METHOD  MultiPageEvents , Click, 0FFFFFDA8h, METHOD, , VT_I4
  DEFINE_COM_DISP_METHOD  MultiPageEvents , DblClick, 0FFFFFDA7h, METHOD, , VT_I4,VT_BYREF OR VT_USERDEFINED
  DEFINE_COM_DISP_METHOD  MultiPageEvents , Error, 0FFFFFDA0h, METHOD, , VT_I4,VT_I2,VT_BYREF OR VT_USERDEFINED,VT_I4,VT_BSTR,VT_BSTR,VT_I4,VT_BYREF OR VT_USERDEFINED
  DEFINE_COM_DISP_METHOD  MultiPageEvents , KeyDown, 0FFFFFDA6h, METHOD, , VT_BYREF OR VT_USERDEFINED,VT_I2
  DEFINE_COM_DISP_METHOD  MultiPageEvents , KeyPress, 0FFFFFDA5h, METHOD, , VT_BYREF OR VT_USERDEFINED
  DEFINE_COM_DISP_METHOD  MultiPageEvents , KeyUp, 0FFFFFDA4h, METHOD, , VT_BYREF OR VT_USERDEFINED,VT_I2
  DEFINE_COM_DISP_METHOD  MultiPageEvents , Layout, 0302h, METHOD, , VT_I4
  DEFINE_COM_DISP_METHOD  MultiPageEvents , MouseDown, 0FFFFFDA3h, METHOD, , VT_I4,VT_I2,VT_I2,VT_R4,VT_R4
  DEFINE_COM_DISP_METHOD  MultiPageEvents , MouseMove, 0FFFFFDA2h, METHOD, , VT_I4,VT_I2,VT_I2,VT_R4,VT_R4
  DEFINE_COM_DISP_METHOD  MultiPageEvents , MouseUp, 0FFFFFDA1h, METHOD, , VT_I4,VT_I2,VT_I2,VT_R4,VT_R4
  DEFINE_COM_DISP_METHOD  MultiPageEvents , RemoveControl, 0303h, METHOD, , VT_I4,VT_BYREF OR VT_USERDEFINED
  DEFINE_COM_DISP_METHOD  MultiPageEvents , Scroll, 0304h, METHOD, , VT_I4,VT_USERDEFINED,VT_USERDEFINED,VT_R4,VT_R4,VT_BYREF OR VT_USERDEFINED,VT_BYREF OR VT_USERDEFINED
  DEFINE_COM_DISP_METHOD  MultiPageEvents , Zoom, 0305h, METHOD, , VT_I4,VT_BYREF OR VT_I2

;--- LabelControlEvents, Type=DISPATCH, GUID={978C9E22-D4B0-11CE-BF2D-00AA003F40D0}

  DEFINE_COM_DISP_METHOD  LabelControlEvents , BeforeDragOver, 03h, METHOD, , VT_BYREF OR VT_USERDEFINED,VT_BYREF OR VT_USERDEFINED,VT_R4,VT_R4,VT_USERDEFINED,VT_BYREF OR VT_USERDEFINED,VT_I2
  DEFINE_COM_DISP_METHOD  LabelControlEvents , BeforeDropOrPaste, 04h, METHOD, , VT_BYREF OR VT_USERDEFINED,VT_USERDEFINED,VT_BYREF OR VT_USERDEFINED,VT_R4,VT_R4,VT_BYREF OR VT_USERDEFINED,VT_I2
  DEFINE_COM_DISP_METHOD  LabelControlEvents , Click, 0FFFFFDA8h, METHOD, 
  DEFINE_COM_DISP_METHOD  LabelControlEvents , DblClick, 0FFFFFDA7h, METHOD, , VT_BYREF OR VT_USERDEFINED
  DEFINE_COM_DISP_METHOD  LabelControlEvents , Error, 0FFFFFDA0h, METHOD, , VT_I2,VT_BYREF OR VT_USERDEFINED,VT_I4,VT_BSTR,VT_BSTR,VT_I4,VT_BYREF OR VT_USERDEFINED
  DEFINE_COM_DISP_METHOD  LabelControlEvents , MouseDown, 0FFFFFDA3h, METHOD, , VT_I2,VT_I2,VT_R4,VT_R4
  DEFINE_COM_DISP_METHOD  LabelControlEvents , MouseMove, 0FFFFFDA2h, METHOD, , VT_I2,VT_I2,VT_R4,VT_R4
  DEFINE_COM_DISP_METHOD  LabelControlEvents , MouseUp, 0FFFFFDA1h, METHOD, , VT_I2,VT_I2,VT_R4,VT_R4

;--- CommandButtonEvents, Type=DISPATCH, GUID={7B020EC1-AF6C-11CE-9F46-00AA00574A4F}

  DEFINE_COM_DISP_METHOD  CommandButtonEvents , BeforeDragOver, 03h, METHOD, , VT_BYREF OR VT_USERDEFINED,VT_BYREF OR VT_USERDEFINED,VT_R4,VT_R4,VT_USERDEFINED,VT_BYREF OR VT_USERDEFINED,VT_I2
  DEFINE_COM_DISP_METHOD  CommandButtonEvents , BeforeDropOrPaste, 04h, METHOD, , VT_BYREF OR VT_USERDEFINED,VT_USERDEFINED,VT_BYREF OR VT_USERDEFINED,VT_R4,VT_R4,VT_BYREF OR VT_USERDEFINED,VT_I2
  DEFINE_COM_DISP_METHOD  CommandButtonEvents , Click, 0FFFFFDA8h, METHOD, 
  DEFINE_COM_DISP_METHOD  CommandButtonEvents , DblClick, 0FFFFFDA7h, METHOD, , VT_BYREF OR VT_USERDEFINED
  DEFINE_COM_DISP_METHOD  CommandButtonEvents , Error, 0FFFFFDA0h, METHOD, , VT_I2,VT_BYREF OR VT_USERDEFINED,VT_I4,VT_BSTR,VT_BSTR,VT_I4,VT_BYREF OR VT_USERDEFINED
  DEFINE_COM_DISP_METHOD  CommandButtonEvents , KeyDown, 0FFFFFDA6h, METHOD, , VT_BYREF OR VT_USERDEFINED,VT_I2
  DEFINE_COM_DISP_METHOD  CommandButtonEvents , KeyPress, 0FFFFFDA5h, METHOD, , VT_BYREF OR VT_USERDEFINED
  DEFINE_COM_DISP_METHOD  CommandButtonEvents , KeyUp, 0FFFFFDA4h, METHOD, , VT_BYREF OR VT_USERDEFINED,VT_I2
  DEFINE_COM_DISP_METHOD  CommandButtonEvents , MouseDown, 0FFFFFDA3h, METHOD, , VT_I2,VT_I2,VT_R4,VT_R4
  DEFINE_COM_DISP_METHOD  CommandButtonEvents , MouseMove, 0FFFFFDA2h, METHOD, , VT_I2,VT_I2,VT_R4,VT_R4
  DEFINE_COM_DISP_METHOD  CommandButtonEvents , MouseUp, 0FFFFFDA1h, METHOD, , VT_I2,VT_I2,VT_R4,VT_R4

;--- MdcTextEvents, Type=DISPATCH, GUID={8BD21D12-EC42-11CE-9E0D-00AA006002F3}

  DEFINE_COM_DISP_METHOD  MdcTextEvents , BeforeDragOver, 03h, METHOD, , VT_BYREF OR VT_USERDEFINED,VT_BYREF OR VT_USERDEFINED,VT_R4,VT_R4,VT_USERDEFINED,VT_BYREF OR VT_USERDEFINED,VT_I2
  DEFINE_COM_DISP_METHOD  MdcTextEvents , BeforeDropOrPaste, 04h, METHOD, , VT_BYREF OR VT_USERDEFINED,VT_USERDEFINED,VT_BYREF OR VT_USERDEFINED,VT_R4,VT_R4,VT_BYREF OR VT_USERDEFINED,VT_I2
  DEFINE_COM_DISP_METHOD  MdcTextEvents , Change, 02h, METHOD, 
  DEFINE_COM_DISP_METHOD  MdcTextEvents , DblClick, 0FFFFFDA7h, METHOD, , VT_BYREF OR VT_USERDEFINED
  DEFINE_COM_DISP_METHOD  MdcTextEvents , DropButtonClick, 07D2h, METHOD, 
  DEFINE_COM_DISP_METHOD  MdcTextEvents , Error, 0FFFFFDA0h, METHOD, , VT_I2,VT_BYREF OR VT_USERDEFINED,VT_I4,VT_BSTR,VT_BSTR,VT_I4,VT_BYREF OR VT_USERDEFINED
  DEFINE_COM_DISP_METHOD  MdcTextEvents , KeyDown, 0FFFFFDA6h, METHOD, , VT_BYREF OR VT_USERDEFINED,VT_I2
  DEFINE_COM_DISP_METHOD  MdcTextEvents , KeyPress, 0FFFFFDA5h, METHOD, , VT_BYREF OR VT_USERDEFINED
  DEFINE_COM_DISP_METHOD  MdcTextEvents , KeyUp, 0FFFFFDA4h, METHOD, , VT_BYREF OR VT_USERDEFINED,VT_I2
  DEFINE_COM_DISP_METHOD  MdcTextEvents , MouseDown, 0FFFFFDA3h, METHOD, , VT_I2,VT_I2,VT_R4,VT_R4
  DEFINE_COM_DISP_METHOD  MdcTextEvents , MouseMove, 0FFFFFDA2h, METHOD, , VT_I2,VT_I2,VT_R4,VT_R4
  DEFINE_COM_DISP_METHOD  MdcTextEvents , MouseUp, 0FFFFFDA1h, METHOD, , VT_I2,VT_I2,VT_R4,VT_R4

;--- end of type library ---
