; ==================================================================================================
; Title:      GetInternetTime_Shared.inc
; Author:     G. Friedrich
; Version:    C.1.0
; Purpose:    ObjAsm GetInternetTime.
; Notes:      Version C.1.0, January 2021
;               - First release.
; ==================================================================================================


;General information
APP_TITLE                     textequ   <GetInternetTime>
ABOUT_TEXT                    textequ   <GetInternetTime>
COPYRIGHT                     textequ   <G. Friedrich   January 2021> 
VER_FILEVERSION               equ       2,0,0,0
VER_FILEVERSION_STR           textequ   <2.0>
VER_PRODUCTVERSION            equ       2,0,0,0
VER_PRODUCTVERSION_STR        equ       <2.0>

;Build information - updated automatically -
BUILD_NUMBER                  equ       19
BUILD_DATE_STR                textequ   <17.04.2021>
BUILD_BITNESS                 equ       32
BUILD_MODE                    equ       DBG

