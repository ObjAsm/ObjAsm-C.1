.data
MY_DIC_ITEMS label MY_DIC_ITEM
MY_DIC_ITEM <$OfsTStr("the", 0)>
MY_DIC_ITEM <$OfsTStr("and", 0)>
MY_DIC_ITEM <$OfsTStr("to", 0)>
MY_DIC_ITEM <$OfsTStr("of", 0)>
MY_DIC_ITEM <$OfsTStr("a", 0)>
MY_DIC_ITEM <$OfsTStr("in", 0)>
MY_DIC_ITEM <$OfsTStr("is", 0)>
MY_DIC_ITEM <$OfsTStr("that", 0)>
MY_DIC_ITEM <$OfsTStr("for", 0)>
MY_DIC_ITEM <$OfsTStr("I", 0)>
MY_DIC_ITEM <$OfsTStr("you", 0)>
MY_DIC_ITEM <$OfsTStr("it", 0)>
MY_DIC_ITEM <$OfsTStr("with", 0)>
MY_DIC_ITEM <$OfsTStr("on", 0)>
MY_DIC_ITEM <$OfsTStr("as", 0)>
MY_DIC_ITEM <$OfsTStr("are", 0)>
MY_DIC_ITEM <$OfsTStr("be", 0)>
MY_DIC_ITEM <$OfsTStr("this", 0)>
MY_DIC_ITEM <$OfsTStr("was", 0)>
MY_DIC_ITEM <$OfsTStr("have", 0)>
MY_DIC_ITEM <$OfsTStr("or", 0)>
MY_DIC_ITEM <$OfsTStr("at", 0)>
MY_DIC_ITEM <$OfsTStr("not", 0)>
MY_DIC_ITEM <$OfsTStr("your", 0)>
MY_DIC_ITEM <$OfsTStr("from", 0)>
MY_DIC_ITEM <$OfsTStr("we", 0)>
MY_DIC_ITEM <$OfsTStr("by", 0)>
MY_DIC_ITEM <$OfsTStr("will", 0)>
MY_DIC_ITEM <$OfsTStr("can", 0)>
MY_DIC_ITEM <$OfsTStr("but", 0)>
MY_DIC_ITEM <$OfsTStr("they", 0)>
MY_DIC_ITEM <$OfsTStr("an", 0)>
MY_DIC_ITEM <$OfsTStr("he", 0)>
MY_DIC_ITEM <$OfsTStr("all", 0)>
MY_DIC_ITEM <$OfsTStr("has", 0)>
MY_DIC_ITEM <$OfsTStr("if", 0)>
MY_DIC_ITEM <$OfsTStr("their", 0)>
MY_DIC_ITEM <$OfsTStr("one", 0)>
MY_DIC_ITEM <$OfsTStr("do", 0)>
MY_DIC_ITEM <$OfsTStr("more", 0)>
MY_DIC_ITEM <$OfsTStr("n't", 0)>
MY_DIC_ITEM <$OfsTStr("my", 0)>
MY_DIC_ITEM <$OfsTStr("his", 0)>
MY_DIC_ITEM <$OfsTStr("so", 0)>
MY_DIC_ITEM <$OfsTStr("there", 0)>
MY_DIC_ITEM <$OfsTStr("about", 0)>
MY_DIC_ITEM <$OfsTStr("which", 0)>
MY_DIC_ITEM <$OfsTStr("when", 0)>
MY_DIC_ITEM <$OfsTStr("what", 0)>
MY_DIC_ITEM <$OfsTStr("out", 0)>
MY_DIC_ITEM <$OfsTStr("up", 0)>
MY_DIC_ITEM <$OfsTStr("our", 0)>
MY_DIC_ITEM <$OfsTStr("who", 0)>
MY_DIC_ITEM <$OfsTStr("also", 0)>
MY_DIC_ITEM <$OfsTStr("had", 0)>
MY_DIC_ITEM <$OfsTStr("time", 0)>
MY_DIC_ITEM <$OfsTStr("some", 0)>
MY_DIC_ITEM <$OfsTStr("would", 0)>
MY_DIC_ITEM <$OfsTStr("were", 0)>
MY_DIC_ITEM <$OfsTStr("like", 0)>
MY_DIC_ITEM <$OfsTStr("been", 0)>
MY_DIC_ITEM <$OfsTStr("just", 0)>
MY_DIC_ITEM <$OfsTStr("her", 0)>
MY_DIC_ITEM <$OfsTStr("new", 0)>
MY_DIC_ITEM <$OfsTStr("other", 0)>
MY_DIC_ITEM <$OfsTStr("them", 0)>
MY_DIC_ITEM <$OfsTStr("she", 0)>
MY_DIC_ITEM <$OfsTStr("people", 0)>
MY_DIC_ITEM <$OfsTStr("these", 0)>
MY_DIC_ITEM <$OfsTStr("no", 0)>
MY_DIC_ITEM <$OfsTStr("get", 0)>
MY_DIC_ITEM <$OfsTStr("how", 0)>
MY_DIC_ITEM <$OfsTStr("me", 0)>
MY_DIC_ITEM <$OfsTStr("into", 0)>
MY_DIC_ITEM <$OfsTStr("than", 0)>
MY_DIC_ITEM <$OfsTStr("only", 0)>
MY_DIC_ITEM <$OfsTStr("its", 0)>
MY_DIC_ITEM <$OfsTStr("most", 0)>
MY_DIC_ITEM <$OfsTStr("may", 0)>
MY_DIC_ITEM <$OfsTStr("any", 0)>
MY_DIC_ITEM <$OfsTStr("many", 0)>
MY_DIC_ITEM <$OfsTStr("make", 0)>
MY_DIC_ITEM <$OfsTStr("then", 0)>
MY_DIC_ITEM <$OfsTStr("well", 0)>
MY_DIC_ITEM <$OfsTStr("first", 0)>
MY_DIC_ITEM <$OfsTStr("very", 0)>
MY_DIC_ITEM <$OfsTStr("over", 0)>
MY_DIC_ITEM <$OfsTStr("now", 0)>
MY_DIC_ITEM <$OfsTStr("could", 0)>
MY_DIC_ITEM <$OfsTStr("after", 0)>
MY_DIC_ITEM <$OfsTStr("even", 0)>
MY_DIC_ITEM <$OfsTStr("because", 0)>
MY_DIC_ITEM <$OfsTStr("us", 0)>
MY_DIC_ITEM <$OfsTStr("said", 0)>
MY_DIC_ITEM <$OfsTStr("good", 0)>
MY_DIC_ITEM <$OfsTStr("way", 0)>
MY_DIC_ITEM <$OfsTStr("two", 0)>
MY_DIC_ITEM <$OfsTStr("should", 0)>
MY_DIC_ITEM <$OfsTStr("work", 0)>
MY_DIC_ITEM <$OfsTStr("use", 0)>
MY_DIC_ITEM <$OfsTStr("through", 0)>
MY_DIC_ITEM <$OfsTStr("see", 0)>
MY_DIC_ITEM <$OfsTStr("know", 0)>
MY_DIC_ITEM <$OfsTStr("did", 0)>
MY_DIC_ITEM <$OfsTStr("much", 0)>
MY_DIC_ITEM <$OfsTStr("where", 0)>
MY_DIC_ITEM <$OfsTStr("years", 0)>
MY_DIC_ITEM <$OfsTStr("need", 0)>
MY_DIC_ITEM <$OfsTStr("him", 0)>
MY_DIC_ITEM <$OfsTStr("back", 0)>
MY_DIC_ITEM <$OfsTStr("such", 0)>
MY_DIC_ITEM <$OfsTStr("those", 0)>
MY_DIC_ITEM <$OfsTStr("being", 0)>
MY_DIC_ITEM <$OfsTStr("day", 0)>
MY_DIC_ITEM <$OfsTStr("take", 0)>
MY_DIC_ITEM <$OfsTStr("while", 0)>
MY_DIC_ITEM <$OfsTStr("here", 0)>
MY_DIC_ITEM <$OfsTStr("before", 0)>
MY_DIC_ITEM <$OfsTStr("does", 0)>
MY_DIC_ITEM <$OfsTStr("great", 0)>
MY_DIC_ITEM <$OfsTStr("year", 0)>
MY_DIC_ITEM <$OfsTStr("go", 0)>
MY_DIC_ITEM <$OfsTStr("help", 0)>
MY_DIC_ITEM <$OfsTStr("want", 0)>
MY_DIC_ITEM <$OfsTStr("really", 0)>
MY_DIC_ITEM <$OfsTStr("think", 0)>
MY_DIC_ITEM <$OfsTStr("best", 0)>
MY_DIC_ITEM <$OfsTStr("life", 0)>
MY_DIC_ITEM <$OfsTStr("each", 0)>
MY_DIC_ITEM <$OfsTStr("made", 0)>
MY_DIC_ITEM <$OfsTStr("right", 0)>
MY_DIC_ITEM <$OfsTStr("world", 0)>
MY_DIC_ITEM <$OfsTStr("business", 0)>
MY_DIC_ITEM <$OfsTStr("home", 0)>
MY_DIC_ITEM <$OfsTStr("own", 0)>
MY_DIC_ITEM <$OfsTStr("down", 0)>
MY_DIC_ITEM <$OfsTStr("still", 0)>
MY_DIC_ITEM <$OfsTStr("used", 0)>
MY_DIC_ITEM <$OfsTStr("find", 0)>
MY_DIC_ITEM <$OfsTStr("around", 0)>
MY_DIC_ITEM <$OfsTStr("going", 0)>
MY_DIC_ITEM <$OfsTStr("every", 0)>
MY_DIC_ITEM <$OfsTStr("both", 0)>
MY_DIC_ITEM <$OfsTStr("last", 0)>
MY_DIC_ITEM <$OfsTStr("off", 0)>
MY_DIC_ITEM <$OfsTStr("too", 0)>
MY_DIC_ITEM <$OfsTStr("same", 0)>
MY_DIC_ITEM <$OfsTStr("information", 0)>
MY_DIC_ITEM <$OfsTStr("little", 0)>
MY_DIC_ITEM <$OfsTStr("another", 0)>
MY_DIC_ITEM <$OfsTStr("look", 0)>
MY_DIC_ITEM <$OfsTStr("few", 0)>
MY_DIC_ITEM <$OfsTStr("long", 0)>
MY_DIC_ITEM <$OfsTStr("part", 0)>
MY_DIC_ITEM <$OfsTStr("since", 0)>
MY_DIC_ITEM <$OfsTStr("things", 0)>
MY_DIC_ITEM <$OfsTStr("place", 0)>
MY_DIC_ITEM <$OfsTStr("am", 0)>
MY_DIC_ITEM <$OfsTStr("between", 0)>
MY_DIC_ITEM <$OfsTStr("during", 0)>
MY_DIC_ITEM <$OfsTStr("different", 0)>
MY_DIC_ITEM <$OfsTStr("must", 0)>
MY_DIC_ITEM <$OfsTStr("come", 0)>
MY_DIC_ITEM <$OfsTStr("using", 0)>
MY_DIC_ITEM <$OfsTStr("however", 0)>
MY_DIC_ITEM <$OfsTStr("without", 0)>
MY_DIC_ITEM <$OfsTStr("high", 0)>
MY_DIC_ITEM <$OfsTStr("why", 0)>
MY_DIC_ITEM <$OfsTStr("something", 0)>
MY_DIC_ITEM <$OfsTStr("online", 0)>
MY_DIC_ITEM <$OfsTStr("system", 0)>
MY_DIC_ITEM <$OfsTStr("better", 0)>
MY_DIC_ITEM <$OfsTStr("three", 0)>
MY_DIC_ITEM <$OfsTStr("never", 0)>
MY_DIC_ITEM <$OfsTStr("always", 0)>
MY_DIC_ITEM <$OfsTStr("love", 0)>
MY_DIC_ITEM <$OfsTStr("say", 0)>
MY_DIC_ITEM <$OfsTStr("might", 0)>
MY_DIC_ITEM <$OfsTStr("next", 0)>
MY_DIC_ITEM <$OfsTStr("company", 0)>
MY_DIC_ITEM <$OfsTStr("state", 0)>
MY_DIC_ITEM <$OfsTStr("number", 0)>
MY_DIC_ITEM <$OfsTStr("again", 0)>
MY_DIC_ITEM <$OfsTStr("free", 0)>
MY_DIC_ITEM <$OfsTStr("lot", 0)>
MY_DIC_ITEM <$OfsTStr("under", 0)>
MY_DIC_ITEM <$OfsTStr("family", 0)>
MY_DIC_ITEM <$OfsTStr("found", 0)>
MY_DIC_ITEM <$OfsTStr("within", 0)>
MY_DIC_ITEM <$OfsTStr("give", 0)>
MY_DIC_ITEM <$OfsTStr("set", 0)>
MY_DIC_ITEM <$OfsTStr("school", 0)>
MY_DIC_ITEM <$OfsTStr("important", 0)>
MY_DIC_ITEM <$OfsTStr("water", 0)>
MY_DIC_ITEM <$OfsTStr("able", 0)>
MY_DIC_ITEM <$OfsTStr("keep", 0)>
MY_DIC_ITEM <$OfsTStr("got", 0)>
MY_DIC_ITEM <$OfsTStr("sure", 0)>
MY_DIC_ITEM <$OfsTStr("end", 0)>
MY_DIC_ITEM <$OfsTStr("money", 0)>
MY_DIC_ITEM <$OfsTStr("service", 0)>
MY_DIC_ITEM <$OfsTStr("small", 0)>
MY_DIC_ITEM <$OfsTStr("put", 0)>
MY_DIC_ITEM <$OfsTStr("experience", 0)>
MY_DIC_ITEM <$OfsTStr("having", 0)>
MY_DIC_ITEM <$OfsTStr("once", 0)>
MY_DIC_ITEM <$OfsTStr("available", 0)>
MY_DIC_ITEM <$OfsTStr("health", 0)>
MY_DIC_ITEM <$OfsTStr("support", 0)>
MY_DIC_ITEM <$OfsTStr("often", 0)>
MY_DIC_ITEM <$OfsTStr("including", 0)>
MY_DIC_ITEM <$OfsTStr("days", 0)>
MY_DIC_ITEM <$OfsTStr("away", 0)>
MY_DIC_ITEM <$OfsTStr("old", 0)>
MY_DIC_ITEM <$OfsTStr("area", 0)>
MY_DIC_ITEM <$OfsTStr("feel", 0)>
MY_DIC_ITEM <$OfsTStr("read", 0)>
MY_DIC_ITEM <$OfsTStr("show", 0)>
MY_DIC_ITEM <$OfsTStr("big", 0)>
MY_DIC_ITEM <$OfsTStr("against", 0)>
MY_DIC_ITEM <$OfsTStr("thing", 0)>
MY_DIC_ITEM <$OfsTStr("order", 0)>
MY_DIC_ITEM <$OfsTStr("program", 0)>
MY_DIC_ITEM <$OfsTStr("though", 0)>
MY_DIC_ITEM <$OfsTStr("city", 0)>
MY_DIC_ITEM <$OfsTStr("group", 0)>
MY_DIC_ITEM <$OfsTStr("services", 0)>
MY_DIC_ITEM <$OfsTStr("site", 0)>
MY_DIC_ITEM <$OfsTStr("making", 0)>
MY_DIC_ITEM <$OfsTStr("course", 0)>
MY_DIC_ITEM <$OfsTStr("point", 0)>
MY_DIC_ITEM <$OfsTStr("children", 0)>
MY_DIC_ITEM <$OfsTStr("times", 0)>
MY_DIC_ITEM <$OfsTStr("team", 0)>
MY_DIC_ITEM <$OfsTStr("game", 0)>
MY_DIC_ITEM <$OfsTStr("along", 0)>
MY_DIC_ITEM <$OfsTStr("let", 0)>
MY_DIC_ITEM <$OfsTStr("house", 0)>
MY_DIC_ITEM <$OfsTStr("today", 0)>
MY_DIC_ITEM <$OfsTStr("body", 0)>
MY_DIC_ITEM <$OfsTStr("working", 0)>
MY_DIC_ITEM <$OfsTStr("case", 0)>
MY_DIC_ITEM <$OfsTStr("man", 0)>
MY_DIC_ITEM <$OfsTStr("real", 0)>
MY_DIC_ITEM <$OfsTStr("provide", 0)>
MY_DIC_ITEM <$OfsTStr("care", 0)>
MY_DIC_ITEM <$OfsTStr("public", 0)>
MY_DIC_ITEM <$OfsTStr("top", 0)>
MY_DIC_ITEM <$OfsTStr("looking", 0)>
MY_DIC_ITEM <$OfsTStr("several", 0)>
MY_DIC_ITEM <$OfsTStr("start", 0)>
MY_DIC_ITEM <$OfsTStr("less", 0)>
MY_DIC_ITEM <$OfsTStr("process", 0)>
MY_DIC_ITEM <$OfsTStr("become", 0)>
MY_DIC_ITEM <$OfsTStr("actually", 0)>
MY_DIC_ITEM <$OfsTStr("local", 0)>
MY_DIC_ITEM <$OfsTStr("together", 0)>
MY_DIC_ITEM <$OfsTStr("person", 0)>
MY_DIC_ITEM <$OfsTStr("change", 0)>
MY_DIC_ITEM <$OfsTStr("book", 0)>
MY_DIC_ITEM <$OfsTStr("enough", 0)>
MY_DIC_ITEM <$OfsTStr("getting", 0)>
MY_DIC_ITEM <$OfsTStr("week", 0)>
MY_DIC_ITEM <$OfsTStr("power", 0)>
MY_DIC_ITEM <$OfsTStr("until", 0)>
MY_DIC_ITEM <$OfsTStr("market", 0)>
MY_DIC_ITEM <$OfsTStr("fact", 0)>
MY_DIC_ITEM <$OfsTStr("god", 0)>
MY_DIC_ITEM <$OfsTStr("food", 0)>
MY_DIC_ITEM <$OfsTStr("students", 0)>
MY_DIC_ITEM <$OfsTStr("full", 0)>
MY_DIC_ITEM <$OfsTStr("women", 0)>
MY_DIC_ITEM <$OfsTStr("community", 0)>
MY_DIC_ITEM <$OfsTStr("name", 0)>
MY_DIC_ITEM <$OfsTStr("second", 0)>
MY_DIC_ITEM <$OfsTStr("data", 0)>
MY_DIC_ITEM <$OfsTStr("government", 0)>
MY_DIC_ITEM <$OfsTStr("says", 0)>
MY_DIC_ITEM <$OfsTStr("others", 0)>
MY_DIC_ITEM <$OfsTStr("ever", 0)>
MY_DIC_ITEM <$OfsTStr("yet", 0)>
MY_DIC_ITEM <$OfsTStr("research", 0)>
MY_DIC_ITEM <$OfsTStr("done", 0)>
MY_DIC_ITEM <$OfsTStr("left", 0)>
MY_DIC_ITEM <$OfsTStr("far", 0)>
MY_DIC_ITEM <$OfsTStr("large", 0)>
MY_DIC_ITEM <$OfsTStr("called", 0)>
MY_DIC_ITEM <$OfsTStr("doing", 0)>
MY_DIC_ITEM <$OfsTStr("already", 0)>
MY_DIC_ITEM <$OfsTStr("development", 0)>
MY_DIC_ITEM <$OfsTStr("social", 0)>
MY_DIC_ITEM <$OfsTStr("open", 0)>
MY_DIC_ITEM <$OfsTStr("possible", 0)>
MY_DIC_ITEM <$OfsTStr("side", 0)>
MY_DIC_ITEM <$OfsTStr("play", 0)>
MY_DIC_ITEM <$OfsTStr("means", 0)>
MY_DIC_ITEM <$OfsTStr("needs", 0)>
MY_DIC_ITEM <$OfsTStr("try", 0)>
MY_DIC_ITEM <$OfsTStr("came", 0)>
MY_DIC_ITEM <$OfsTStr("ca", 0)>
MY_DIC_ITEM <$OfsTStr("based", 0)>
MY_DIC_ITEM <$OfsTStr("hard", 0)>
MY_DIC_ITEM <$OfsTStr("thought", 0)>
MY_DIC_ITEM <$OfsTStr("products", 0)>
MY_DIC_ITEM <$OfsTStr("national", 0)>
MY_DIC_ITEM <$OfsTStr("quality", 0)>
MY_DIC_ITEM <$OfsTStr("level", 0)>
MY_DIC_ITEM <$OfsTStr("live", 0)>
MY_DIC_ITEM <$OfsTStr("design", 0)>
MY_DIC_ITEM <$OfsTStr("makes", 0)>
MY_DIC_ITEM <$OfsTStr("project", 0)>
MY_DIC_ITEM <$OfsTStr("line", 0)>
MY_DIC_ITEM <$OfsTStr("night", 0)>
MY_DIC_ITEM <$OfsTStr("least", 0)>
MY_DIC_ITEM <$OfsTStr("whether", 0)>
MY_DIC_ITEM <$OfsTStr("job", 0)>
MY_DIC_ITEM <$OfsTStr("car", 0)>
MY_DIC_ITEM <$OfsTStr("example", 0)>
MY_DIC_ITEM <$OfsTStr("include", 0)>
MY_DIC_ITEM <$OfsTStr("following", 0)>
MY_DIC_ITEM <$OfsTStr("given", 0)>
MY_DIC_ITEM <$OfsTStr("website", 0)>
MY_DIC_ITEM <$OfsTStr("past", 0)>
MY_DIC_ITEM <$OfsTStr("plan", 0)>
MY_DIC_ITEM <$OfsTStr("offer", 0)>
MY_DIC_ITEM <$OfsTStr("buy", 0)>
MY_DIC_ITEM <$OfsTStr("call", 0)>
MY_DIC_ITEM <$OfsTStr("went", 0)>
MY_DIC_ITEM <$OfsTStr("simply", 0)>
MY_DIC_ITEM <$OfsTStr("hand", 0)>
MY_DIC_ITEM <$OfsTStr("music", 0)>
MY_DIC_ITEM <$OfsTStr("easy", 0)>
MY_DIC_ITEM <$OfsTStr("problem", 0)>
MY_DIC_ITEM <$OfsTStr("men", 0)>
MY_DIC_ITEM <$OfsTStr("country", 0)>
MY_DIC_ITEM <$OfsTStr("took", 0)>
MY_DIC_ITEM <$OfsTStr("four", 0)>
MY_DIC_ITEM <$OfsTStr("members", 0)>
MY_DIC_ITEM <$OfsTStr("form", 0)>
MY_DIC_ITEM <$OfsTStr("personal", 0)>
MY_DIC_ITEM <$OfsTStr("control", 0)>
MY_DIC_ITEM <$OfsTStr("energy", 0)>
MY_DIC_ITEM <$OfsTStr("room", 0)>
MY_DIC_ITEM <$OfsTStr("head", 0)>
MY_DIC_ITEM <$OfsTStr("pay", 0)>
MY_DIC_ITEM <$OfsTStr("create", 0)>
MY_DIC_ITEM <$OfsTStr("run", 0)>
MY_DIC_ITEM <$OfsTStr("kind", 0)>
MY_DIC_ITEM <$OfsTStr("credit", 0)>
MY_DIC_ITEM <$OfsTStr("almost", 0)>
MY_DIC_ITEM <$OfsTStr("believe", 0)>
MY_DIC_ITEM <$OfsTStr("quite", 0)>
MY_DIC_ITEM <$OfsTStr("mind", 0)>
MY_DIC_ITEM <$OfsTStr("law", 0)>
MY_DIC_ITEM <$OfsTStr("early", 0)>
MY_DIC_ITEM <$OfsTStr("comes", 0)>
MY_DIC_ITEM <$OfsTStr("states", 0)>
MY_DIC_ITEM <$OfsTStr("usually", 0)>
MY_DIC_ITEM <$OfsTStr("companies", 0)>
MY_DIC_ITEM <$OfsTStr("web", 0)>
MY_DIC_ITEM <$OfsTStr("taking", 0)>
MY_DIC_ITEM <$OfsTStr("started", 0)>
MY_DIC_ITEM <$OfsTStr("later", 0)>
MY_DIC_ITEM <$OfsTStr("although", 0)>
MY_DIC_ITEM <$OfsTStr("story", 0)>
MY_DIC_ITEM <$OfsTStr("per", 0)>
MY_DIC_ITEM <$OfsTStr("future", 0)>
MY_DIC_ITEM <$OfsTStr("known", 0)>
MY_DIC_ITEM <$OfsTStr("someone", 0)>
MY_DIC_ITEM <$OfsTStr("across", 0)>
MY_DIC_ITEM <$OfsTStr("rather", 0)>
MY_DIC_ITEM <$OfsTStr("young", 0)>
MY_DIC_ITEM <$OfsTStr("whole", 0)>
MY_DIC_ITEM <$OfsTStr("special", 0)>
MY_DIC_ITEM <$OfsTStr("everything", 0)>
MY_DIC_ITEM <$OfsTStr("months", 0)>
MY_DIC_ITEM <$OfsTStr("anything", 0)>
MY_DIC_ITEM <$OfsTStr("training", 0)>
MY_DIC_ITEM <$OfsTStr("url", 0)>
MY_DIC_ITEM <$OfsTStr("bit", 0)>
MY_DIC_ITEM <$OfsTStr("seen", 0)>
MY_DIC_ITEM <$OfsTStr("product", 0)>
MY_DIC_ITEM <$OfsTStr("american", 0)>
MY_DIC_ITEM <$OfsTStr("please", 0)>
MY_DIC_ITEM <$OfsTStr("management", 0)>
MY_DIC_ITEM <$OfsTStr("cost", 0)>
MY_DIC_ITEM <$OfsTStr("either", 0)>
MY_DIC_ITEM <$OfsTStr("light", 0)>
MY_DIC_ITEM <$OfsTStr("university", 0)>
MY_DIC_ITEM <$OfsTStr("face", 0)>
MY_DIC_ITEM <$OfsTStr("due", 0)>
MY_DIC_ITEM <$OfsTStr("nothing", 0)>
MY_DIC_ITEM <$OfsTStr("human", 0)>
MY_DIC_ITEM <$OfsTStr("event", 0)>
MY_DIC_ITEM <$OfsTStr("history", 0)>
MY_DIC_ITEM <$OfsTStr("probably", 0)>
MY_DIC_ITEM <$OfsTStr("friends", 0)>
MY_DIC_ITEM <$OfsTStr("learn", 0)>
MY_DIC_ITEM <$OfsTStr("current", 0)>
MY_DIC_ITEM <$OfsTStr("tell", 0)>
MY_DIC_ITEM <$OfsTStr("general", 0)>
MY_DIC_ITEM <$OfsTStr("price", 0)>
MY_DIC_ITEM <$OfsTStr("list", 0)>
MY_DIC_ITEM <$OfsTStr("type", 0)>
MY_DIC_ITEM <$OfsTStr("building", 0)>
MY_DIC_ITEM <$OfsTStr("industry", 0)>
MY_DIC_ITEM <$OfsTStr("bad", 0)>
MY_DIC_ITEM <$OfsTStr("check", 0)>
MY_DIC_ITEM <$OfsTStr("everyone", 0)>
MY_DIC_ITEM <$OfsTStr("office", 0)>
MY_DIC_ITEM <$OfsTStr("idea", 0)>
MY_DIC_ITEM <$OfsTStr("internet", 0)>
MY_DIC_ITEM <$OfsTStr("news", 0)>
MY_DIC_ITEM <$OfsTStr("million", 0)>
MY_DIC_ITEM <$OfsTStr("video", 0)>
MY_DIC_ITEM <$OfsTStr("among", 0)>
MY_DIC_ITEM <$OfsTStr("air", 0)>
MY_DIC_ITEM <$OfsTStr("especially", 0)>
MY_DIC_ITEM <$OfsTStr("told", 0)>
MY_DIC_ITEM <$OfsTStr("results", 0)>
MY_DIC_ITEM <$OfsTStr("post", 0)>
MY_DIC_ITEM <$OfsTStr("hours", 0)>
MY_DIC_ITEM <$OfsTStr("international", 0)>
MY_DIC_ITEM <$OfsTStr("center", 0)>
MY_DIC_ITEM <$OfsTStr("understand", 0)>
MY_DIC_ITEM <$OfsTStr("above", 0)>
MY_DIC_ITEM <$OfsTStr("addition", 0)>
MY_DIC_ITEM <$OfsTStr("major", 0)>
MY_DIC_ITEM <$OfsTStr("education", 0)>
MY_DIC_ITEM <$OfsTStr("white", 0)>
MY_DIC_ITEM <$OfsTStr("particular", 0)>
MY_DIC_ITEM <$OfsTStr("problems", 0)>
MY_DIC_ITEM <$OfsTStr("media", 0)>
MY_DIC_ITEM <$OfsTStr("according", 0)>
MY_DIC_ITEM <$OfsTStr("upon", 0)>
MY_DIC_ITEM <$OfsTStr("page", 0)>
MY_DIC_ITEM <$OfsTStr("continue", 0)>
MY_DIC_ITEM <$OfsTStr("black", 0)>
MY_DIC_ITEM <$OfsTStr("study", 0)>
MY_DIC_ITEM <$OfsTStr("issues", 0)>
MY_DIC_ITEM <$OfsTStr("inside", 0)>
MY_DIC_ITEM <$OfsTStr("technology", 0)>
MY_DIC_ITEM <$OfsTStr("five", 0)>
MY_DIC_ITEM <$OfsTStr("value", 0)>
MY_DIC_ITEM <$OfsTStr("further", 0)>
MY_DIC_ITEM <$OfsTStr("access", 0)>
MY_DIC_ITEM <$OfsTStr("reason", 0)>
MY_DIC_ITEM <$OfsTStr("short", 0)>
MY_DIC_ITEM <$OfsTStr("true", 0)>
MY_DIC_ITEM <$OfsTStr("simple", 0)>
MY_DIC_ITEM <$OfsTStr("natural", 0)>
MY_DIC_ITEM <$OfsTStr("amount", 0)>
MY_DIC_ITEM <$OfsTStr("search", 0)>
MY_DIC_ITEM <$OfsTStr("result", 0)>
MY_DIC_ITEM <$OfsTStr("taken", 0)>
MY_DIC_ITEM <$OfsTStr("main", 0)>
MY_DIC_ITEM <$OfsTStr("heart", 0)>
MY_DIC_ITEM <$OfsTStr("space", 0)>
MY_DIC_ITEM <$OfsTStr("financial", 0)>
MY_DIC_ITEM <$OfsTStr("ago", 0)>
MY_DIC_ITEM <$OfsTStr("trying", 0)>
MY_DIC_ITEM <$OfsTStr("question", 0)>
MY_DIC_ITEM <$OfsTStr("living", 0)>
MY_DIC_ITEM <$OfsTStr("likely", 0)>
MY_DIC_ITEM <$OfsTStr("interest", 0)>
MY_DIC_ITEM <$OfsTStr("various", 0)>
MY_DIC_ITEM <$OfsTStr("insurance", 0)>
MY_DIC_ITEM <$OfsTStr("common", 0)>
MY_DIC_ITEM <$OfsTStr("move", 0)>
MY_DIC_ITEM <$OfsTStr("child", 0)>
MY_DIC_ITEM <$OfsTStr("yourself", 0)>
MY_DIC_ITEM <$OfsTStr("report", 0)>
MY_DIC_ITEM <$OfsTStr("certain", 0)>
MY_DIC_ITEM <$OfsTStr("share", 0)>
MY_DIC_ITEM <$OfsTStr("single", 0)>
MY_DIC_ITEM <$OfsTStr("close", 0)>
MY_DIC_ITEM <$OfsTStr("instead", 0)>
MY_DIC_ITEM <$OfsTStr("bring", 0)>
MY_DIC_ITEM <$OfsTStr("works", 0)>
MY_DIC_ITEM <$OfsTStr("age", 0)>
MY_DIC_ITEM <$OfsTStr("s", 0)>
MY_DIC_ITEM <$OfsTStr("season", 0)>
MY_DIC_ITEM <$OfsTStr("hope", 0)>
MY_DIC_ITEM <$OfsTStr("coming", 0)>
MY_DIC_ITEM <$OfsTStr("areas", 0)>
MY_DIC_ITEM <$OfsTStr("ask", 0)>
MY_DIC_ITEM <$OfsTStr("medical", 0)>
MY_DIC_ITEM <$OfsTStr("low", 0)>
MY_DIC_ITEM <$OfsTStr("games", 0)>
MY_DIC_ITEM <$OfsTStr("turn", 0)>
MY_DIC_ITEM <$OfsTStr("key", 0)>
MY_DIC_ITEM <$OfsTStr("party", 0)>
MY_DIC_ITEM <$OfsTStr("add", 0)>
MY_DIC_ITEM <$OfsTStr("month", 0)>
MY_DIC_ITEM <$OfsTStr("seems", 0)>
MY_DIC_ITEM <$OfsTStr("view", 0)>
MY_DIC_ITEM <$OfsTStr("fun", 0)>
MY_DIC_ITEM <$OfsTStr("matter", 0)>
MY_DIC_ITEM <$OfsTStr("words", 0)>
MY_DIC_ITEM <$OfsTStr("needed", 0)>
MY_DIC_ITEM <$OfsTStr("potatos", 0)>
MY_DIC_ITEM <$OfsTStr("gerhard", 0)>
MY_DIC_ITEM <$OfsTStr("Axel", 0)>
MY_DIC_ITEM <$OfsTStr("peperoni", 0)>
MY_DIC_ITEM <$OfsTStr("addsy", 0)>
MY_DIC_ITEM <$OfsTStr("celestial", 0)>
MY_DIC_ITEM <$OfsTStr("cable", 0)>
MY_DIC_ITEM <$OfsTStr("sensor", 0)>
MY_DIC_ITEM <$OfsTStr("bolts", 0)>
MY_DIC_ITEM <$OfsTStr("darkmatter", 0)>
MY_DIC_ITEM <$OfsTStr("pencils", 0)>
MY_DIC_ITEM <$OfsTStr("needsof", 0)>

MY_DIC_ITEM_COUNT = ($ - offset MY_DIC_ITEMS)/sizeof(MY_DIC_ITEM)
